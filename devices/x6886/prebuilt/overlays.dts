/dts-v1/;

/ {

	fragment@0 {
		target = <0xffffffff>;

		__overlay__ {
			bootargs_ext = "printk.devkmsg=on";
		};
	};

	fragment@1 {
		target = <0xffffffff>;

		__overlay__ {
			compatible = "mediatek,disp-leds";

			backlight {
				led-mode = <0x04>;
				pwm_config = <0x00 0x01 0x00 0x00 0x00>;
				max-brightness = <0x13ff>;
				max-hw-brightness = <0x13ff>;
			};
		};
	};

	fragment@2 {
		target = <0xffffffff>;

		__overlay__ {

			tran_ldo@28 {
				compatible = "tran,tran_ldo";
				reg = <0x28>;

				regulators {

					TRANLDO13 {
						regulator-name = "TRANLDO13";
						regulator-min-microvolt = <0x927c0>;
						regulator-max-microvolt = <0x1b7740>;
						phandle = <0x37>;
					};

					TRANLDO23 {
						regulator-name = "TRANLDO23";
						regulator-min-microvolt = <0x927c0>;
						regulator-max-microvolt = <0x1b7740>;
						phandle = <0x05>;
					};

					TRANLDO33 {
						regulator-name = "TRANLDO33";
						regulator-min-microvolt = <0x124f80>;
						regulator-max-microvolt = <0x325aa0>;
						phandle = <0x36>;
					};

					TRANLDO43 {
						regulator-name = "TRANLDO43";
						regulator-min-microvolt = <0x124f80>;
						regulator-max-microvolt = <0x325aa0>;
						phandle = <0x3a>;
					};
				};
			};

			hl1280-audioswitch@42 {
				compatible = "mediatek,hl1280-audioswitch";
				reg = <0x42>;
				status = "okay";
				phandle = <0x42>;
			};
		};
	};

	fragment@3 {
		target = <0xffffffff>;

		__overlay__ {

			lcm_rst_out0_gpio {
				phandle = <0x02>;

				pins_cmd_dat {
					pinmux = <0x5500>;
					slew-rate = <0x01>;
					output-low;
				};
			};

			lcm_rst_out1_gpio {
				phandle = <0x03>;

				pins_cmd_dat {
					pinmux = <0x5500>;
					slew-rate = <0x01>;
					output-high;
				};
			};

			lcm_dsi_te {
				phandle = <0x04>;

				pins_cmd_dat {
					pinmux = <0x5301>;
				};
			};

			dispdefault {
				phandle = <0x01>;
			};
		};
	};

	fragment@4 {
		target = <0xffffffff>;

		__overlay__ {
			pinctrl-names = "dispdefault\0lcm_rst_out0_gpio\0lcm_rst_out1_gpio\0mode_te_te";
			pinctrl-0 = <0x01>;
			pinctrl-1 = <0x02>;
			pinctrl-2 = <0x03>;
			pinctrl-3 = <0x04>;
			status = "okay";
		};
	};

	fragment@5 {
		target = <0xffffffff>;

		__overlay__ {
			pinctrl-names = "dispdefault\0lcm_rst_out0_gpio\0lcm_rst_out1_gpio\0mode_te_te";
			pinctrl-0 = <0x01>;
			pinctrl-1 = <0x02>;
			pinctrl-2 = <0x03>;
			pinctrl-3 = <0x04>;
			helper-value = <0x00 0x01 0x01 0x01 0x01 0x00 0x01 0x00 0x00 0x00 0x00 0x00 0x01 0x00 0x01 0x01 0x01 0x01 0x00 0x01 0x01 0x01 0x00 0x01 0x00 0x01 0x00 0x00 0x00 0x00 0x01 0x00 0x00 0x00 0x00 0x00 0x01 0x00 0x00 0x01 0x01 0x00 0x01 0x00 0x00 0x00 0x01 0x00 0x00 0x00>;
			status = "okay";
		};
	};

	fragment@6 {
		target = <0xffffffff>;

		__overlay__ {
			status = "okay";
			#address-cells = <0x01>;
			#size-cells = <0x00>;

			panel1@0 {
				compatible = "nt37706a,fhdp,dsi,vdo,dsc,boe,boe,144hz,x6886";
				reg = <0x00>;
				vddi-gpios = <0xffffffff 0x31 0x00>;
				dvdd-supply = <0x05>;
				vci-gpios = <0xffffffff 0x3d 0x00>;
				reset-gpios = <0xffffffff 0x55 0x00>;
				pinctrl-names = "default";
				doze_backlight = <0x03 0x02 0x0f 0x1d>;

				port {

					endpoint {
						remote-endpoint = <0x06>;
						phandle = <0x07>;
					};
				};
			};

			panel2@0 {
				compatible = "vtdr6126a,fhdp,dsi,vdo,dsc,tm,tm,144hz,x6886";
				reg = <0x01>;
				vddi-gpios = <0xffffffff 0x31 0x00>;
				dvdd-supply = <0x05>;
				vci-gpios = <0xffffffff 0x3d 0x00>;
				reset-gpios = <0xffffffff 0x55 0x00>;
				pinctrl-names = "default";
				doze_backlight = <0x03 0x02 0x0f 0x1d>;

				port {

					endpoint {
						remote-endpoint = <0x06>;
						phandle = <0x43>;
					};
				};
			};

			ports {

				port {

					endpoint {
						remote-endpoint = <0x07>;
						phandle = <0x06>;
					};
				};
			};
		};
	};

	fragment@7 {
		target = <0xffffffff>;

		__overlay__ {

			tran_audio_controller {
				compatible = "tran-audio-controller";
				tran_pa_type = <0x02>;
				tran_typec_type = <0x02>;
				typec_usb_change_gpio = <0xffffffff 0x76 0x00>;
				phandle = <0x44>;
			};
		};
	};

	fragment@8 {
		target = <0xffffffff>;

		__overlay__ {

			aw87xxx_pa@58 {
				compatible = "awinic,aw87xxx_pa";
				reg = <0x58>;
				dev_index = <0x01>;
				status = "okay";
			};

			aw87xxx_pa@59 {
				compatible = "awinic,aw87xxx_pa";
				reg = <0x59>;
				dev_index = <0x00>;
				status = "okay";
			};
		};
	};

	fragment@9 {
		target = <0xffffffff>;

		__overlay__ {
			clock-frequency = <0x61a80>;
			status = "okay";

			tms_nfc@28 {
				status = "okay";
				compatible = "tms,nfc";
				reg = <0x28>;
				tms,device-name = "tms_nfc";
				tms,device-count = <0x01>;
				tms,irq-gpio = <0xffffffff 0x01 0x00>;
				tms,ven-gpio = <0xffffffff 0x41 0x00>;
				tms,download-gpio = <0xffffffff 0x08 0x00>;
				phandle = <0x45>;
			};
		};
	};

	fragment@10 {
		target = <0xffffffff>;

		__overlay__ {

			blkio {
				atomic_storage_io_enable = <0x01>;
				flash_type = <0x01>;
				phandle = <0x46>;
			};
		};
	};

	fragment@11 {
		target = <0xffffffff>;

		__overlay__ {

			gps_default {
				phandle = <0x08>;
			};

			gps_l1_lna@0 {
				phandle = <0x09>;

				pins_cmd_dat {
					pinmux = <0x1900>;
					output-low;
				};
			};

			gps_l1_lna@1 {
				phandle = <0x0a>;

				pins_cmd_dat {
					pinmux = <0x1902>;
				};
			};

			gps_l1_lna@2 {
				phandle = <0x0b>;

				pins_cmd_dat {
					pinmux = <0x1900>;
					output-high;
				};
			};

			gps_l5_lna@0 {
				phandle = <0x0c>;

				pins_cmd_dat {
					pinmux = <0x1a00>;
					output-low;
				};
			};

			gps_l5_lna@1 {
				phandle = <0x0d>;

				pins_cmd_dat {
					pinmux = <0x1a02>;
				};
			};

			gps_l5_lna@2 {
				phandle = <0x0e>;

				pins_cmd_dat {
					pinmux = <0x1a00>;
					output-high;
				};
			};
		};
	};

	fragment@12 {
		target = <0xffffffff>;

		__overlay__ {
			pinctrl-names = "default\0gps_l1_lna_disable\0gps_l1_lna_dsp_ctrl\0gps_l1_lna_enable\0gps_l5_lna_disable\0gps_l5_lna_dsp_ctrl\0gps_l5_lna_enable";
			pinctrl-0 = <0x08>;
			pinctrl-1 = <0x09>;
			pinctrl-2 = <0x0a>;
			pinctrl-3 = <0x0b>;
			pinctrl-4 = <0x0c>;
			pinctrl-5 = <0x0d>;
			pinctrl-6 = <0x0e>;
			status = "okay";
		};
	};

	fragment@13 {
		target = <0xffffffff>;

		__overlay__ {

			home {
				linux,keycodes = <0x25d>;
				wakeup-source;
			};
		};
	};

	fragment@14 {
		target = <0xffffffff>;

		__overlay__ {
			min-volt = <0x2dc6c0>;
			max-volt = <0x3567e0>;
		};
	};

	fragment@15 {
		target = <0xffffffff>;

		__overlay__ {
			supplier-num = <0x02>;
			supplier-vendor-0 = "BOE";
			supplier-0 = "nt37706a_fhdp_dsi_vdo_dsc_boe_boe_144hz_x6886, focaltech, ft3682g";
			supplier-vendor-fwname-0 = "focaltech_ts_fw.bin";
			supplier-resolution-0 = <0x10>;
			supplier-vendor-1 = "TM";
			supplier-1 = "vtdr6126a_fhdp_dsi_vdo_dsc_tm_tm_144hz_x6886, chipsemi, chct5560";
			supplier-vendor-fwname-1 = "chipsemi_ts_fw.bin";
			supplier-resolution-1 = <0x10>;
			touchscreen,fingerprint-support;
			touchscreen,dynamic-report-rate-support;
			touchscreen,pocket-mode-amt-support;
			touchscreen,esports-engine = <0x02>;
		};
	};

	fragment@16 {
		target = <0xffffffff>;

		__overlay__ {

			touch@0 {
				compatible = "focaltech,fts\0chipsemi,chsc_cap_touch";
				reg = <0x00>;
				status = "ok";
				spi-max-frequency = <0x7a1200>;
				interrupt-parent = <0xffffffff>;
				vtouch-supply = <0xffffffff>;
				focaltech,iovdd-gpio = <0xffffffff 0x0f 0x00>;
				focaltech,irq-gpio = <0xffffffff 0x0c 0x00>;
				focaltech,reset-gpio = <0xffffffff 0x74 0x00>;
				focaltech,avdd-gpio = <0xffffffff 0x96 0x00>;
				focaltech,max-touch-number = <0x0a>;
				focaltech,display-coords = <0x00 0x00 0x437f 0x95ff>;
				focaltech,fod-function-support;
				focaltech,custom-mistouch-support;
				focaltech,pocket-function-support;
				focaltech,switch-report-support;
				pinctrl-names = "default\0state_spi_mode";
				pinctrl-0 = <0x0f>;
				pinctrl-1 = <0x10>;
				chipsemi,int-gpio = <0xffffffff 0x0c 0x00>;
				chipsemi,rst-gpio = <0xffffffff 0x74 0x00>;
				chipsemi,vdd-gpio = <0xffffffff 0x96 0x00>;
				chipsemi,vddio-gpio = <0xffffffff 0x0f 0x00>;
				chipsemi,x-coords = <0x437f>;
				chipsemi,y-coords = <0x95ff>;
				chipsemi,multiple-solution = <0x10>;
				chipsemi,fp_x_center = <0x21c>;
				chipsemi,fp_y_center = <0x87d>;
				chipsemi,fp_radius = <0x3f>;
				chipsemi,fod-function-support;
				chipsemi,pocket-function-support;
				chipsemi,switch-report-support;
				chipsemi,custom-mistouch-support;
				chipsemi,rawdata_limits_row = <0x28>;
				chipsemi,rawdata_limits_col = <0x12>;
				chipsemi,short_limits = <0x2bc>;
				invalid_row_col = <0xff 0xff 0xff 0xff 0xff 0xff 0xff 0xff>;
				rawdata_lo_limits = <0xca6 0x17b7 0x1c27 0x1c49 0x1c42 0x1c64 0x1c60 0x1c89 0x194f 0x19a0 0x1ced 0x1ca5 0x1cac 0x1c9d 0x1cb0 0x1c90 0x1819 0x812 0x18ea 0x1b78 0x1bb1 0x1bc3 0x1bc2 0x1be0 0x1bdc 0x1c17 0x1696 0x16f1 0x1c74 0x1c1c 0x1c1f 0x1c0e 0x1c15 0x1c03 0x1bc2 0x1ebd 0x1ca8 0x1bed 0x1bf1 0x1c03 0x1c05 0x1c26 0x1c21 0x1c2a 0x1c5c 0x1cc4 0x1c83 0x1c5e 0x1c62 0x1c50 0x1c53 0x1c40 0x1c33 0x1bc6 0x1c8a 0x1bc9 0x1bd1 0x1be5 0x1be6 0x1c0b 0x1c04 0x1c09 0x1c01 0x1c67 0x1c63 0x1c41 0x1c42 0x1c30 0x1c37 0x1c1f 0x1c0d 0x1ba1 0x1cb3 0x1bf7 0x1c01 0x1c19 0x1c1b 0x1c3e 0x1c3a 0x1c42 0x1c37 0x1c9d 0x1c98 0x1c78 0x1c7b 0x1c69 0x1c6c 0x1c51 0x1c3e 0x1bcf 0x1cd3 0x1c23 0x1c2f 0x1c49 0x1c4b 0x1c6d 0x1c6b 0x1c74 0x1c6a 0x1cd3 0x1ccb 0x1caa 0x1cad 0x1c9a 0x1c9f 0x1c81 0x1c6c 0x1bfd 0x1cd8 0x1c39 0x1c44 0x1c61 0x1c61 0x1c86 0x1c81 0x1c89 0x1c82 0x1ce9 0x1ce4 0x1cc2 0x1cc4 0x1cb0 0x1cb3 0x1c96 0x1c81 0x1c12 0x1cbb 0x1c27 0x1c33 0x1c4f 0x1c51 0x1c76 0x1c73 0x1c7c 0x1c76 0x1ce0 0x1cd8 0x1cbe 0x1cbb 0x1ca3 0x1ca4 0x1c86 0x1c70 0x1c03 0x1ca3 0x1c15 0x1c22 0x1c3e 0x1c42 0x1c67 0x1c65 0x1c6f 0x1c69 0x1cd1 0x1cc9 0x1cad 0x1caa 0x1c92 0x1c93 0x1c74 0x1c60 0x1bf2 0x1cc4 0x1c3b 0x1c49 0x1c67 0x1c69 0x1c91 0x1c8e 0x1c98 0x1c93 0x1cfe 0x1cf5 0x1cd2 0x1cd3 0x1cbb 0x1cbb 0x1c9d 0x1c85 0x1c14 0x1cb8 0x1c32 0x1c3e 0x1c5b 0x1c5d 0x1c87 0x1c86 0x1c91 0x1c8c 0x1cf4 0x1cef 0x1cc8 0x1cc9 0x1cae 0x1cae 0x1c8e 0x1c77 0x1c05 0x1cc3 0x1c44 0x1c4e 0x1c6d 0x1c6d 0x1c97 0x1c97 0x1ca1 0x1c9d 0x1d07 0x1cff 0x1cdb 0x1cd8 0x1cc0 0x1cbd 0x1c9b 0x1c86 0x1c13 0x1cd0 0x1c51 0x1c5c 0x1c7a 0x1c7c 0x1ca5 0x1ca4 0x1cb0 0x1caa 0x1d15 0x1d0c 0x1ce9 0x1ce7 0x1ccd 0x1ccb 0x1ca9 0x1c92 0x1c20 0x1cc1 0x1c40 0x1c49 0x1c66 0x1c65 0x1c90 0x1c90 0x1c99 0x1c94 0x1d02 0x1cfb 0x1cd7 0x1cd6 0x1cbd 0x1cba 0x1c9b 0x1c7f 0x1c0e 0x1cc0 0x1c36 0x1c3c 0x1c5a 0x1c58 0x1c80 0x1c81 0x1c8b 0x1c86 0x1cf5 0x1ced 0x1cc8 0x1cc7 0x1cb0 0x1cac 0x1c8a 0x1c71 0x1bfd 0x1ccb 0x1c30 0x1c35 0x1c51 0x1c4c 0x1c76 0x1c77 0x1c83 0x1c7f 0x1cf2 0x1ce0 0x1cbd 0x1cba 0x1ca3 0x1c9d 0x1c79 0x1c61 0x1bf0 0x1cba 0x1c03 0x1c01 0x1c1f 0x1c15 0x1c3e 0x1c41 0x1c4e 0x1c49 0x1cc9 0x1cac 0x1c87 0x1c87 0x1c6a 0x1c69 0x1c45 0x1c2e 0x1bc6 0x1d10 0x1c1f 0x1c15 0x1c30 0x1c26 0x1c51 0x1c53 0x1c5e 0x1c5c 0x1ce5 0x1cbe 0x1c9c 0x1c98 0x1c81 0x1c7f 0x1c5b 0x1c46 0x1bda 0x1da5 0x1c42 0x1c2a 0x1c40 0x1c31 0x1c5a 0x1c5e 0x1c6b 0x1c69 0x1cf6 0x1ccb 0x1ca7 0x1ca3 0x1c8c 0x1c8e 0x1c6a 0x1c53 0x1bee 0x1fbc 0x1cab 0x1c62 0x1c68 0x1c53 0x1c7e 0x1c7f 0x1c8c 0x1c89 0x1d42 0x1d03 0x1cdc 0x1cd9 0x1cc8 0x1cd0 0x1cad 0x1c98 0x1d98 0x1b3a 0x1b8c 0x1ba5 0x1bd0 0x1be8 0x1c1f 0x1c2a 0x1c43 0x1c4b 0x1cc0 0x1cc1 0x1ca4 0x1cb0 0x1c86 0x1c76 0x1c62 0x1c5b 0x1caa 0x1b63 0x1bb5 0x1bd0 0x1bfa 0x1c15 0x1c4a 0x1c57 0x1c6d 0x1c76 0x1ce4 0x1ce5 0x1ccc 0x1cd6 0x1cae 0x1c9b 0x1c87 0x1c7b 0x1ca7 0x1b75 0x1bc6 0x1be2 0x1c0c 0x1c26 0x1c5a 0x1c67 0x1c7b 0x1c86 0x1cf5 0x1cf7 0x1cde 0x1ce8 0x1cbf 0x1cad 0x1c98 0x1c8c 0x1caf 0x1b67 0x1bb5 0x1bcf 0x1bf8 0x1c12 0x1c49 0x1c56 0x1c69 0x1c73 0x1cdf 0x1ce3 0x1ccc 0x1cd7 0x1caa 0x1c9c 0x1c85 0x1c7a 0x1c92 0x1b4f 0x1b9f 0x1bb8 0x1be3 0x1bfd 0x1c32 0x1c3e 0x1c52 0x1c5b 0x1cc7 0x1ccb 0x1cb3 0x1cbd 0x1c92 0x1c83 0x1c6d 0x1c61 0x1c70 0x1b3b 0x1b8a 0x1ba4 0x1bcd 0x1be7 0x1c1d 0x1c28 0x1c3d 0x1c46 0x1cb3 0x1cb5 0x1c9b 0x1ca4 0x1c7c 0x1c6d 0x1c56 0x1c49 0x1c54 0x1b40 0x1b8e 0x1ba6 0x1bd0 0x1be9 0x1c1e 0x1c2a 0x1c3f 0x1c48 0x1cb5 0x1cb7 0x1c9c 0x1ca6 0x1c7c 0x1c6e 0x1c58 0x1c4b 0x1c4e 0x1b3f 0x1b91 0x1bab 0x1bd3 0x1beb 0x1c22 0x1c2e 0x1c44 0x1c4b 0x1cb8 0x1cb9 0x1c9f 0x1ca7 0x1c7e 0x1c70 0x1c59 0x1c50 0x1c48 0x1b03 0x1b50 0x1b6c 0x1b93 0x1bab 0x1bdf 0x1bed 0x1c01 0x1c09 0x1c76 0x1c76 0x1c5b 0x1c65 0x1c3b 0x1c31 0x1c1b 0x1c10 0x1c04 0x1b34 0x1b82 0x1b9d 0x1bc5 0x1bdc 0x1c0f 0x1c1a 0x1c2e 0x1c36 0x1ca5 0x1ca3 0x1c8a 0x1c92 0x1c6a 0x1c60 0x1c4b 0x1c3e 0x1c34 0x1b13 0x1b5e 0x1b78 0x1ba0 0x1bb5 0x1be7 0x1bf0 0x1c03 0x1c0a 0x1c7a 0x1c77 0x1c62 0x1c69 0x1c40 0x1c34 0x1c21 0x1c19 0x1c0d 0x1b08 0x1b54 0x1b6b 0x1b91 0x1ba6 0x1bd4 0x1bde 0x1bf2 0x1bf8 0x1c67 0x1c65 0x1c4f 0x1c57 0x1c2f 0x1c24 0x1c10 0x1c09 0x1c01 0x1b03 0x1b4b 0x1b64 0x1b86 0x1b9d 0x1bd0 0x1bda 0x1beb 0x1bf2 0x1c61 0x1c61 0x1c4b 0x1c53 0x1c28 0x1c21 0x1c0c 0x1c07 0x1c07 0x1ac0 0x1b09 0x1b22 0x1b45 0x1b58 0x1b89 0x1b93 0x1ba4 0x1bad 0x1c1a 0x1c19 0x1c04 0x1c0b 0x1be1 0x1bdb 0x1bc7 0x1bc2 0x1bcf 0x1abd 0x1b03 0x1b19 0x1b3d 0x1b52 0x1b83 0x1b8e 0x1b9c 0x1ba5 0x1c14 0x1c12 0x1bfe 0x1c05 0x1bda 0x1bd6 0x1bc2 0x1bbc 0x1bd8 0x1aab 0x1af2 0x1b08 0x1b2a 0x1b3e 0x1b6f 0x1b79 0x1b89 0x1b91 0x1c01 0x1c02 0x1bec 0x1bf2 0x1bc9 0x1bc8 0x1bb3 0x1bb1 0x1bec 0x1ac4 0x1b0c 0x1b1f 0x1b42 0x1b56 0x1b88 0x1b93 0x1ba2 0x1ba9 0x1c1a 0x1c1b 0x1c05 0x1c0c 0x1be1 0x1be1 0x1bd1 0x1bd1 0x1c4b 0x1a97 0x1ae2 0x1af4 0x1b16 0x1b2b 0x1b5f 0x1b6b 0x1b7a 0x1b83 0x1bf5 0x1bf1 0x1bd9 0x1bdf 0x1bb5 0x1bb6 0x1ba4 0x1bae 0x1cb3 0x17bd 0x1ae1 0x1b26 0x1b48 0x1b5c 0x1b92 0x1b9d 0x1baf 0x1bba 0x1c2c 0x1c26 0x1c0c 0x1c0e 0x1be2 0x1be5 0x1bda 0x1bc1 0x1c5d 0xb32 0x18af 0x1c33 0x1c3e 0x1c34 0x1c86 0x1cf5 0x1d7d 0x1df7 0x1e66 0x1df5 0x1d62 0x1cff 0x1cb5 0x1cdb 0x1ce6 0x19ce 0xed4>;
				rawdata_hi_limits = <0x1d82 0x3755 0x3a77 0x3abf 0x3ab0 0x3af6 0x3aec 0x3b43 0x3b0d 0x3bca 0x3c13 0x3b7d 0x3b8c 0x3b6d 0x3b92 0x3b50 0x3839 0x12d4 0x3a22 0x390a 0x3981 0x39a7 0x39a4 0x39e2 0x39dc 0x3a55 0x34b2 0x3589 0x3b18 0x3a60 0x3a65 0x3a44 0x3a51 0x3a2d 0x39a6 0x47b9 0x3b84 0x39fd 0x3a07 0x3a2d 0x3a2f 0x3a74 0x3a69 0x3a7c 0x3ae6 0x3bbc 0x3b37 0x3aea 0x3af0 0x3acc 0x3ad3 0x3aac 0x3a8f 0x39ae 0x3b46 0x39b3 0x39c5 0x39ef 0x39f0 0x3a3d 0x3a2e 0x3a39 0x3a27 0x3afb 0x3af3 0x3aad 0x3ab0 0x3a8a 0x3a99 0x3a67 0x3a41 0x3961 0x3b9b 0x3a13 0x3a29 0x3a5b 0x3a5d 0x3aa6 0x3a9e 0x3ab0 0x3a99 0x3b6d 0x3b62 0x3b20 0x3b25 0x3aff 0x3b06 0x3acf 0x3aa6 0x39c1 0x3bdd 0x3a6f 0x3a87 0x3abf 0x3ac1 0x3b09 0x3b03 0x3b16 0x3b02 0x3bdb 0x3bcd 0x3b86 0x3b8d 0x3b66 0x3b71 0x3b31 0x3b06 0x3a1f 0x3be8 0x3a9b 0x3ab4 0x3aef 0x3aef 0x3b3c 0x3b31 0x3b43 0x3b34 0x3c0b 0x3bfe 0x3bba 0x3bbe 0x3b94 0x3b9b 0x3b5c 0x3b31 0x3a4a 0x3ba9 0x3a77 0x3a8f 0x3acb 0x3acf 0x3b1c 0x3b15 0x3b26 0x3b1c 0x3bf8 0x3be6 0x3bb0 0x3ba9 0x3b79 0x3b7c 0x3b3c 0x3b10 0x3a2b 0x3b79 0x3a51 0x3a6e 0x3aa8 0x3aae 0x3afb 0x3af7 0x3b0b 0x3b01 0x3bd7 0x3bc7 0x3b8d 0x3b88 0x3b54 0x3b57 0x3b18 0x3aec 0x3a0a 0x3bbe 0x3aa1 0x3abd 0x3afd 0x3b01 0x3b53 0x3b4e 0x3b62 0x3b57 0x3c34 0x3c23 0x3bda 0x3bdb 0x3ba9 0x3ba9 0x3b6b 0x3b3b 0x3a50 0x3ba4 0x3a8e 0x3aa8 0x3ae3 0x3ae7 0x3b3d 0x3b3c 0x3b53 0x3b48 0x3c20 0x3c15 0x3bc6 0x3bc7 0x3b90 0x3b8e 0x3b4e 0x3b1d 0x3a31 0x3bbb 0x3ab2 0x3ac8 0x3b07 0x3b07 0x3b61 0x3b61 0x3b75 0x3b6d 0x3c49 0x3c39 0x3bed 0x3be8 0x3bb4 0x3baf 0x3b69 0x3b3c 0x3a4d 0x3bd6 0x3acf 0x3ae6 0x3b22 0x3b26 0x3b7d 0x3b7c 0x3b94 0x3b88 0x3c65 0x3c52 0x3c09 0x3c07 0x3bd1 0x3bcb 0x3b85 0x3b54 0x3a68 0x3bb7 0x3aaa 0x3abd 0x3afa 0x3af9 0x3b50 0x3b50 0x3b65 0x3b5a 0x3c3e 0x3c2f 0x3be5 0x3be2 0x3baf 0x3ba8 0x3b67 0x3b2f 0x3a44 0x3bb4 0x3a96 0x3aa4 0x3ae2 0x3adc 0x3b30 0x3b33 0x3b47 0x3b3c 0x3c23 0x3c13 0x3bc6 0x3bc3 0x3b92 0x3b8a 0x3b46 0x3b11 0x3a21 0x3bcb 0x3a8a 0x3a93 0x3acf 0x3ac4 0x3b1a 0x3b1d 0x3b35 0x3b2d 0x3c1c 0x3bf8 0x3baf 0x3ba8 0x3b77 0x3b6b 0x3b21 0x3aef 0x3a04 0x3ba8 0x3a2b 0x3a29 0x3a65 0x3a51 0x3aa8 0x3aad 0x3ac8 0x3abd 0x3bc7 0x3b8a 0x3b3f 0x3b3d 0x3b02 0x3b01 0x3ab5 0x3a84 0x39ac 0x3c5a 0x3a65 0x3a53 0x3a8a 0x3a76 0x3acd 0x3ad1 0x3aea 0x3ae4 0x3c03 0x3bb0 0x3b6a 0x3b62 0x3b33 0x3b2f 0x3ae3 0x3ab8 0x39d6 0x3d91 0x3ab0 0x3a7c 0x3aaa 0x3a8b 0x3ae2 0x3ae8 0x3b03 0x3aff 0x3c24 0x3bcd 0x3b81 0x3b79 0x3b48 0x3b4e 0x3b02 0x3ad1 0x3a00 0x41e8 0x3b89 0x3af2 0x3afe 0x3ad3 0x3b2c 0x3b2f 0x3b4a 0x3b43 0x3cc2 0x3c3f 0x3bee 0x3be9 0x3bc6 0x3bd6 0x3b8d 0x3b62 0x3d74 0x388c 0x3934 0x3969 0x39c2 0x39f4 0x3a67 0x3a7c 0x3ab1 0x3ac3 0x3bb6 0x3bb7 0x3b7c 0x3b92 0x3b3c 0x3b1a 0x3af0 0x3ae3 0x3b88 0x38e1 0x3989 0x39c2 0x3a18 0x3a51 0x3ac0 0x3adb 0x3b09 0x3b1a 0x3bfe 0x3c03 0x3bce 0x3be2 0x3b8e 0x3b67 0x3b3d 0x3b25 0x3b81 0x3905 0x39ac 0x39e8 0x3a3e 0x3a74 0x3ae2 0x3afb 0x3b25 0x3b3c 0x3c23 0x3c27 0x3bf2 0x3c08 0x3bb3 0x3b8d 0x3b62 0x3b4a 0x3b91 0x38e7 0x398b 0x39bf 0x3a16 0x3a4c 0x3abd 0x3ad8 0x3b01 0x3b15 0x3bf5 0x3bfd 0x3bce 0x3be5 0x3b86 0x3b6a 0x3b3b 0x3b24 0x3b56 0x38b7 0x395b 0x3990 0x39e9 0x3a1f 0x3a8e 0x3aa6 0x3ad0 0x3ae3 0x3bc3 0x3bcb 0x3b9b 0x3bad 0x3b56 0x3b37 0x3b09 0x3aef 0x3b10 0x388d 0x3932 0x3968 0x39bd 0x39f1 0x3a61 0x3a78 0x3aa5 0x3ab8 0x3b99 0x3b9f 0x3b67 0x3b7c 0x3b26 0x3b09 0x3ad8 0x3abd 0x3ad4 0x3896 0x3938 0x396a 0x39c2 0x39f7 0x3a64 0x3a7c 0x3aa9 0x3abc 0x3b9f 0x3ba1 0x3b6a 0x3b7e 0x3b26 0x3b0a 0x3ade 0x3ac3 0x3ac8 0x3895 0x393f 0x3975 0x39c9 0x39fb 0x3a6c 0x3a86 0x3ab2 0x3ac3 0x3ba4 0x3ba5 0x3b6f 0x3b81 0x3b2c 0x3b10 0x3adf 0x3acc 0x3abc 0x3817 0x38b8 0x38f2 0x3945 0x3975 0x39e1 0x39ff 0x3a27 0x3a39 0x3b1c 0x3b1a 0x3ae3 0x3af7 0x3a9f 0x3a8b 0x3a5f 0x3a46 0x3a2e 0x387e 0x3920 0x3957 0x39ab 0x39da 0x3a45 0x3a5c 0x3a84 0x3a96 0x3b7d 0x3b77 0x3b44 0x3b54 0x3b02 0x3aee 0x3ac3 0x3aa8 0x3a92 0x383b 0x38d4 0x390c 0x3960 0x398b 0x39f3 0x3a06 0x3a2b 0x3a3c 0x3b24 0x3b1d 0x3af0 0x3aff 0x3aaa 0x3a92 0x3a6b 0x3a59 0x3a41 0x3824 0x38c0 0x38ef 0x393f 0x396a 0x39cc 0x39e0 0x3a08 0x3a16 0x3afb 0x3af7 0x3acb 0x3adb 0x3a87 0x3a70 0x3a48 0x3a39 0x3a27 0x3819 0x38af 0x38e2 0x392a 0x3957 0x39c2 0x39d6 0x39fb 0x3a0a 0x3aef 0x3aef 0x3ac3 0x3ad1 0x3a7a 0x3a69 0x3a40 0x3a35 0x3a35 0x378e 0x3825 0x3858 0x38a1 0x38ca 0x392f 0x3945 0x3968 0x3979 0x3a5c 0x3a5b 0x3a2e 0x3a3d 0x39e5 0x39d9 0x39b1 0x39a4 0x39bf 0x3787 0x3819 0x3847 0x3891 0x38bc 0x3923 0x3938 0x3956 0x3969 0x3a50 0x3a4c 0x3a22 0x3a2f 0x39d6 0x39d0 0x39a4 0x399a 0x39d4 0x3761 0x37f4 0x3822 0x3868 0x3892 0x38f9 0x390f 0x392f 0x393f 0x3a29 0x3a2a 0x39fc 0x3a08 0x39b3 0x39b2 0x3987 0x3983 0x39fc 0x3796 0x382a 0x3853 0x389a 0x38c6 0x392e 0x3943 0x3962 0x3971 0x3a5c 0x3a5f 0x3a31 0x3a3e 0x39e7 0x39e7 0x39c3 0x39c5 0x3ac3 0x3739 0x37d4 0x37fa 0x3840 0x386d 0x38d7 0x38ef 0x3910 0x3921 0x3a0f 0x3a07 0x39d5 0x39e1 0x3989 0x398c 0x3966 0x397c 0x3b9b 0x3763 0x37d1 0x3862 0x38a8 0x38d2 0x3942 0x3957 0x397d 0x3996 0x3a80 0x3a74 0x3a40 0x3a44 0x39e8 0x39ef 0x39d8 0x39a3 0x422f 0x1a21 0x3999 0x3a8f 0x3aa8 0x3a92 0x3b3c 0x3c23 0x3d3d 0x3e3b 0x3f22 0x3e35 0x3d04 0x3c37 0x3b9f 0x3bed 0x3c04 0x3c36 0x2298>;
				phandle = <0x47>;
			};
		};
	};

	fragment@17 {
		target = <0xffffffff>;

		__overlay__ {

			ctp_default {
				phandle = <0x0f>;
			};

			ctp_spimode_default {
				phandle = <0x10>;

				pins_cmd_dat {
					pinmux = <0x2501 0x2301 0x2401 0x2201>;
					drive-strength = <0x02>;
				};
			};
		};
	};

	fragment@18 {
		target = <0xffffffff>;

		__overlay__ {
			difference-fullocv-ith = <0x12c>;
			shutdown-1-time = <0x96>;
			keep-100-percent = <0x01>;
			r-fg-value = <0x32>;
			rfg-mtk-tran-conf-diff = <0x0f>;
			embedded-sel = <0x01>;
			pmic-shutdown-current = <0x14>;
			fg-meter-resistance = <0x64>;
			car-tune-value = <0x64>;
			pmic-min-vol = <0x82dc>;
			poweron-system-iboot = <0x1f4>;
			shutdown-gauge0-voltage = <0x84d0>;
			temperature-t0 = <0x32>;
			temperature-t1 = <0x19>;
			temperature-t2 = <0x0a>;
			temperature-t3 = <0x00>;
			temperature-t4 = <0xfffffff6>;
			g-fg-pseudo100-t0 = <0x64>;
			g-fg-pseudo100-t1 = <0x64>;
			g-fg-pseudo100-t2 = <0x64>;
			g-fg-pseudo100-t3 = <0x64>;
			g-fg-pseudo100-t4 = <0x64>;
			q-max-sys-voltage-bat0 = <0xd16>;
			q-max-sys-voltage-bat1 = <0xd16>;
			q-max-sys-voltage-bat2 = <0xd16>;
			q-max-sys-voltage-bat3 = <0xd16>;
			com-fg-meter-resistance = <0x64>;
			com-r-fg-value = <0x00>;
			enable-tmp-intr-suspend = <0x00>;
			active-table = <0x05>;
			multi-temp-gauge0 = <0x01>;
			rbat-pull-up-volt = <0xaf0>;
			tran_Q_diff = <0x1428 0x1428 0x1428 0x1428>;
			battery0-profile-t0-num = <0x64>;
			battery0-profile-t0-col = <0x04>;
			battery0-profile-t0 = <0x00 0xae38 0x1f4 0x1af 0x210 0xad71 0x1f3 0x1ae 0x421 0xaccb 0x1de 0x19c 0x631 0xac44 0x1f4 0x1af 0x842 0xabc7 0x1f4 0x1af 0xa52 0xab53 0x1f4 0x1af 0xc62 0xaadf 0x1eb 0x1a7 0xe73 0xaa6a 0x1db 0x199 0x1083 0xa9f6 0x1db 0x199 0x1293 0xa982 0x1db 0x199 0x14a4 0xa90e 0x1db 0x199 0x16b4 0xa899 0x1eb 0x1a7 0x18c5 0xa81e 0x1e3 0x1a1 0x1ad5 0xa79f 0x1db 0x199 0x1ce5 0xa721 0x1db 0x199 0x1ef6 0xa6aa 0x1f0 0x1ac 0x2106 0xa624 0x1dd 0x19b 0x2317 0xa5a4 0x1db 0x199 0x2527 0xa525 0x1f4 0x1af 0x2737 0xa4a7 0x1f4 0x1af 0x2948 0xa428 0x1f4 0x1af 0x2b58 0xa3a9 0x1f4 0x1af 0x2d68 0xa32d 0x1fa 0x1b4 0x2f79 0xa2b5 0x205 0x1be 0x3189 0xa237 0x1f4 0x1af 0x339a 0xa1bc 0x1f4 0x1af 0x35aa 0xa148 0x200 0x1b9 0x37ba 0xa0ce 0x200 0x1b9 0x39cb 0xa055 0x1f4 0x1af 0x3bdb 0x9fe7 0x204 0x1bd 0x3dec 0x9f77 0x20d 0x1c4 0x3ffc 0x9f0a 0x20d 0x1c4 0x420c 0x9ea0 0x221 0x1d5 0x441d 0x9e37 0x226 0x1da 0x462d 0x9dcd 0x226 0x1da 0x483d 0x9d63 0x226 0x1da 0x4a4e 0x9d04 0x227 0x1db 0x4c5e 0x9ca5 0x23f 0x1ef 0x4e6f 0x9c46 0x23f 0x1ef 0x507f 0x9be7 0x244 0x1f4 0x528f 0x9b8a 0x25f 0x20b 0x54a0 0x9b33 0x271 0x21b 0x56b0 0x9ad0 0x27b 0x223 0x58c1 0x9a54 0x274 0x21d 0x5ad1 0x99b6 0x233 0x1e5 0x5ce1 0x991e 0x1f1 0x1ac 0x5ef2 0x98ad 0x1db 0x199 0x6102 0x985b 0x1ec 0x1a7 0x6312 0x9811 0x1f4 0x1af 0x6523 0x97c7 0x1e0 0x19d 0x6733 0x9786 0x1f0 0x1ac 0x6944 0x9746 0x1de 0x19c 0x6b54 0x9707 0x1db 0x199 0x6d64 0x96d2 0x1db 0x199 0x6f75 0x969d 0x1f4 0x19a 0x7185 0x9668 0x1f4 0x19a 0x7395 0x9633 0x1f4 0x19a 0x75a6 0x9601 0x1f4 0x19a 0x77b6 0x95d6 0x1fb 0x1a0 0x79c7 0x95a9 0x204 0x1a8 0x7bd7 0x9578 0x1f4 0x19a 0x7de7 0x954d 0x1f4 0x19a 0x7ff8 0x9528 0x201 0x1a5 0x8208 0x9503 0x20d 0x19f 0x8419 0x94df 0x21d 0x1ac 0x8629 0x94bf 0x226 0x1b3 0x8839 0x9498 0x226 0x1b3 0x8a4a 0x9476 0x226 0x1b3 0x8c5a 0x9456 0x226 0x1b3 0x8e6a 0x942d 0x226 0x1b3 0x907b 0x93e6 0x20e 0x1a0 0x928b 0x9388 0x1db 0x177 0x949c 0x9340 0x1db 0x177 0x96ac 0x930c 0x1df 0x17a 0x98bc 0x92e0 0x1f4 0x18c 0x9acd 0x92ab 0x1f4 0x18c 0x9cdd 0x9276 0x1ec 0x185 0x9eee 0x9245 0x1e4 0x17f 0xa0fe 0x921b 0x1e9 0x183 0xa30e 0x91f1 0x1e7 0x182 0xa51f 0x91c1 0x1f4 0x18c 0xa72f 0x9186 0x1f4 0x18c 0xa93f 0x9140 0x1f4 0x18c 0xab50 0x90fd 0x1f4 0x194 0xad60 0x90b6 0x1e1 0x184 0xaf71 0x9064 0x1f0 0x191 0xb181 0x9018 0x1de 0x181 0xb391 0x9007 0x1f2 0x196 0xb5a2 0x8ffc 0x1f4 0x198 0xb7b2 0x8ff1 0x20d 0x1ab 0xb9c3 0x8fdb 0x20d 0x1ab 0xbbd3 0x8fb6 0x215 0x1b2 0xbde3 0x8f4c 0x234 0x1cc 0xbef0 0x8e0f 0x214 0x1b1 0xc074 0x8c12 0x237 0x1ce 0xc284 0x8969 0x275 0x201 0xc495 0x859e 0x2f2 0x266 0xc6e8 0x7f19 0x7df 0x669 0xca46 0x774c 0x18ce 0x1435 0xcc56 0x774c 0x18ce 0x1435>;
			battery0-profile-t1-num = <0x64>;
			battery0-profile-t1-col = <0x04>;
			battery0-profile-t1 = <0x00 0xae6a 0x370 0x2f6 0x210 0xada4 0x36b 0x2f2 0x421 0xad12 0x368 0x2f0 0x631 0xac95 0x34e 0x2d9 0x842 0xac21 0x339 0x2c7 0xa52 0xabb0 0x339 0x2c7 0xc62 0xab46 0x330 0x2bf 0xe73 0xaad8 0x316 0x2a9 0x1083 0xaa69 0x307 0x29c 0x1293 0xa9ff 0x314 0x2a7 0x14a4 0xa990 0x320 0x2b1 0x16b4 0xa91b 0x320 0x2b1 0x18c5 0xa8a0 0x30f 0x2a2 0x1ad5 0xa829 0x307 0x29c 0x1ce5 0xa7ad 0x307 0x29c 0x1ef6 0xa72e 0x2f2 0x28a 0x2106 0xa6af 0x305 0x29a 0x2317 0xa630 0x2ef 0x287 0x2527 0xa5b1 0x307 0x29c 0x2737 0xa533 0x307 0x29c 0x2948 0xa4b2 0x304 0x299 0x2b58 0xa42d 0x2f3 0x28b 0x2d68 0xa3b4 0x301 0x297 0x2f79 0xa330 0x2f6 0x28d 0x3189 0xa2b9 0x2fe 0x294 0x339a 0xa23a 0x2ee 0x286 0x35aa 0xa1c0 0x2fa 0x290 0x37ba 0xa146 0x2fa 0x290 0x39cb 0xa0cd 0x2ee 0x286 0x3bdb 0xa059 0x2ee 0x286 0x3dec 0x9fe5 0x2ee 0x286 0x3ffc 0x9f78 0x301 0x297 0x420c 0x9f06 0x2f3 0x28b 0x441d 0x9e9b 0x31a 0x2ac 0x462d 0x9e3a 0x320 0x2b1 0x483d 0x9dd1 0x339 0x2c7 0x4a4e 0x9d68 0x33a 0x2c7 0x4c5e 0x9d09 0x352 0x2dc 0x4e6f 0x9caa 0x356 0x2e0 0x507f 0x9c4b 0x370 0x2f6 0x528f 0x9bec 0x38b 0x30e 0x54a0 0x9b8d 0x3a5 0x324 0x56b0 0x9b2d 0x3b6 0x333 0x58c1 0x9ac5 0x3ab 0x329 0x5ad1 0x9a47 0x384 0x307 0x5ce1 0x99ad 0x334 0x2c3 0x5ef2 0x9917 0x2e8 0x281 0x6102 0x98a8 0x2d5 0x271 0x6312 0x9849 0x2b1 0x252 0x6523 0x97f9 0x2a3 0x245 0x6733 0x97b8 0x2b8 0x257 0x6944 0x9778 0x2a6 0x249 0x6b54 0x9739 0x2bb 0x25b 0x6d64 0x96fa 0x2a3 0x245 0x6f75 0x96c5 0x2a5 0x248 0x7185 0x9690 0x2b9 0x258 0x7395 0x965b 0x2a7 0x249 0x75a6 0x9626 0x2b6 0x256 0x77b6 0x95f4 0x2aa 0x24c 0x79c7 0x95ca 0x2bc 0x25b 0x7bd7 0x95a0 0x2bc 0x25b 0x7de7 0x957a 0x2c8 0x266 0x7ff8 0x9555 0x2d5 0x271 0x8208 0x952b 0x2d5 0x25b 0x8419 0x9507 0x2e5 0x268 0x8629 0x94e7 0x2ee 0x26f 0x8839 0x94c0 0x2db 0x25f 0x8a4a 0x94a6 0x2e9 0x26b 0x8c5a 0x9488 0x304 0x282 0x8e6a 0x9468 0x307 0x284 0x907b 0x9449 0x307 0x284 0x928b 0x941f 0x2ee 0x26f 0x949c 0x93f4 0x2ec 0x26d 0x96ac 0x93bf 0x2d1 0x257 0x98bc 0x938c 0x2bc 0x245 0x9acd 0x935f 0x2bc 0x245 0x9cdd 0x932d 0x2bc 0x245 0x9eee 0x92ff 0x2bc 0x245 0xa0fe 0x92cf 0x2b1 0x23c 0xa30e 0x92a9 0x2bb 0x245 0xa51f 0x9284 0x2c7 0x24f 0xa72f 0x9254 0x2bc 0x245 0xa93f 0x9219 0x2bc 0x245 0xab50 0x91d9 0x2ce 0x254 0xad60 0x919a 0x2d5 0x25b 0xaf71 0x915a 0x2d5 0x25b 0xb181 0x9109 0x2bf 0x248 0xb391 0x90b5 0x2eb 0x26d 0xb5a2 0x9088 0x2d5 0x25b 0xb7b2 0x9074 0x2d6 0x25b 0xb9c3 0x9072 0x2ee 0x26f 0xba43 0x905d 0x2f2 0x272 0xbac3 0x9045 0x312 0x28d 0xbba8 0x9012 0x339 0x2ae 0xbc8c 0x8f58 0x331 0x2a6 0xbe9c 0x8db2 0x334 0x2a9 0xbfe5 0x8b55 0x368 0x2d5 0xc1f5 0x8808 0x3d0 0x32b 0xc46a 0x82c9 0x534 0x453 0xcc56 0x786e 0x1ba8 0x16fa>;
			battery0-profile-t2-num = <0x64>;
			battery0-profile-t2-col = <0x04>;
			battery0-profile-t2 = <0x00 0xaea6 0x76c 0x5b6 0x210 0xadc2 0x76d 0x5b6 0x421 0xad32 0x782 0x5c6 0x631 0xacbd 0x763 0x5af 0x842 0xac4b 0x73a 0x58f 0xa52 0xabe2 0x725 0x57f 0xc62 0xab7b 0x6ef 0x555 0xe73 0xab18 0x6e5 0x54e 0x1083 0xaaaa 0x6bf 0x530 0x1293 0xaa3b 0x6a4 0x51c 0x14a4 0xa9cc 0x688 0x506 0x16b4 0xa964 0x682 0x502 0x18c5 0xa8f0 0x669 0x4ee 0x1ad5 0xa879 0x659 0x4e2 0x1ce5 0xa7fd 0x645 0x4d3 0x1ef6 0xa77e 0x62b 0x4bf 0x2106 0xa6f6 0x610 0x4aa 0x2317 0xa680 0x60e 0x4a8 0x2527 0xa601 0x60d 0x4a8 0x2737 0xa583 0x5f5 0x495 0x2948 0xa502 0x5ee 0x490 0x2b58 0xa47b 0x5c8 0x472 0x2d68 0xa3fc 0x5d6 0x47d 0x2f79 0xa380 0x5d2 0x47a 0x3189 0xa305 0x5e3 0x487 0x339a 0xa284 0x5cd 0x476 0x35aa 0xa20b 0x5dc 0x482 0x37ba 0xa191 0x5e9 0x48c 0x39cb 0xa117 0x5e6 0x48a 0x3bdb 0xa09f 0x5dc 0x482 0x3dec 0xa02b 0x5dc 0x482 0x3ffc 0x9fb6 0x5ef 0x490 0x420c 0x9f4a 0x5f5 0x495 0x441d 0x9ee1 0x60b 0x4a6 0x462d 0x9e6e 0x625 0x4ba 0x483d 0x9e0d 0x640 0x4cf 0x4a4e 0x9d9a 0x627 0x4bc 0x4c5e 0x9d31 0x62c 0x4bf 0x4e6f 0x9cd0 0x659 0x4e2 0x507f 0x9c69 0x65e 0x4e6 0x528f 0x9c07 0x672 0x4f5 0x54a0 0x9ba1 0x67a 0x4fb 0x56b0 0x9b3a 0x678 0x4fa 0x58c1 0x9ac1 0x64e 0x4da 0x5ad1 0x9a38 0x602 0x49f 0x5ce1 0x99af 0x5b5 0x464 0x5ef2 0x9931 0x58b 0x444 0x6102 0x98b9 0x546 0x40e 0x6312 0x985a 0x52d 0x3fb 0x6523 0x9805 0x519 0x3ec 0x6733 0x97c2 0x529 0x3f8 0x6944 0x9779 0x52d 0x3fb 0x6b54 0x9739 0x52d 0x3fb 0x6d64 0x9703 0x546 0x40e 0x6f75 0x96c5 0x52f 0x3fd 0x7185 0x9690 0x546 0x40e 0x7395 0x965b 0x546 0x40e 0x75a6 0x9624 0x540 0x40a 0x77b6 0x95ea 0x534 0x401 0x79c7 0x95bd 0x546 0x40e 0x7bd7 0x9588 0x546 0x40e 0x7de7 0x955c 0x552 0x418 0x7ff8 0x9537 0x56c 0x42c 0x8208 0x9513 0x578 0x435 0x8419 0x94ed 0x578 0x435 0x8629 0x94c9 0x589 0x442 0x8839 0x94aa 0x5a4 0x457 0x8a4a 0x9482 0x596 0x44c 0x8c5a 0x9469 0x5bc 0x469 0x8e6a 0x9441 0x5c3 0x46f 0x907b 0x9421 0x5ab 0x45c 0x928b 0x940b 0x5c4 0x46f 0x949c 0x93f5 0x5da 0x480 0x96ac 0x93cc 0x5c3 0x46f 0x98bc 0x93ac 0x5c8 0x472 0x9acd 0x938a 0x5cf 0x478 0x9cdd 0x935f 0x5b2 0x462 0x9eee 0x9331 0x5c3 0x46f 0xa0fe 0x9301 0x5ce 0x477 0xa30e 0x92d7 0x5d0 0x479 0xa51f 0x92b2 0x5de 0x483 0xa72f 0x9280 0x5f5 0x495 0xa93f 0x9247 0x616 0x4ae 0xab50 0x9204 0x639 0x4c9 0xad60 0x91c2 0x653 0x4dd 0xaf71 0x9182 0x66e 0x4f2 0xb181 0x9131 0x672 0x4f5 0xb391 0x90ca 0x6a1 0x519 0xb5a2 0x9092 0x708 0x569 0xb7b2 0x9068 0x70d 0x56c 0xb9c3 0x904a 0x77c 0x5c2 0xbbd3 0x9031 0x827 0x645 0xbde3 0x9003 0x931 0x712 0xbff4 0x8fb5 0xb05 0x87a 0xc204 0x8f05 0xef5 0xb81 0xc414 0x8d64 0x1ab7 0x148d 0xc625 0x8aab 0x3d6e 0x2f41 0xc835 0x876e 0x4123 0x321b 0xca46 0x876e 0x4123 0x321b 0xcc56 0x876e 0x4123 0x321b>;
			battery0-profile-t3-num = <0x64>;
			battery0-profile-t3-col = <0x04>;
			battery0-profile-t3 = <0x00 0xb040 0xe2e 0xae8 0x210 0xaeca 0xe26 0xae2 0x421 0xadd5 0xdec 0xab6 0x631 0xad28 0xd8a 0xa6a 0x842 0xaca3 0xd50 0xa3e 0xa52 0xac34 0xcfa 0x9fb 0xc62 0xabd2 0xca1 0x9b7 0xe73 0xab6c 0xc6c 0x98e 0x1083 0xab09 0xc2c 0x95d 0x1293 0xaa9f 0xbd0 0x916 0x14a4 0xaa3b 0xb74 0x8cf 0x16b4 0xa9d6 0xb35 0x89f 0x18c5 0xa96c 0xb11 0x883 0x1ad5 0xa8fb 0xad2 0x853 0x1ce5 0xa887 0xaaa 0x834 0x1ef6 0xa812 0xa7a 0x80f 0x2106 0xa795 0xa5c 0x7f8 0x2317 0xa716 0xa2a 0x7d2 0x2527 0xa6a1 0xa0e 0x7bc 0x2737 0xa623 0x9f4 0x7a8 0x2948 0xa5a2 0x9da 0x794 0x2b58 0xa51b 0x9bf 0x77f 0x2d68 0xa49c 0x9ab 0x770 0x2f79 0xa41d 0x9b3 0x776 0x3189 0xa39f 0x9d6 0x791 0x339a 0xa31c 0x9f6 0x7aa 0x35aa 0xa29c 0x9f6 0x7aa 0x37ba 0xa222 0x9db 0x795 0x39cb 0xa1a3 0x9c4 0x783 0x3bdb 0xa12b 0x9c4 0x783 0x3dec 0xa0b7 0x9c4 0x783 0x3ffc 0xa03b 0x9b1 0x774 0x420c 0x9fc4 0x9ab 0x770 0x441d 0x9f50 0x995 0x75f 0x462d 0x9ee5 0x9c1 0x781 0x483d 0x9e71 0x9c4 0x783 0x4a4e 0x9dfe 0x9dd 0x796 0x4c5e 0x9d93 0x9da 0x794 0x4e6f 0x9d22 0x9c8 0x786 0x507f 0x9cbe 0x9dd 0x796 0x528f 0x9c4d 0x9dd 0x796 0x54a0 0x9be0 0x9d5 0x790 0x56b0 0x9b6c 0x9c4 0x783 0x58c1 0x9af3 0x9a3 0x76a 0x5ad1 0x9a79 0x96d 0x740 0x5ce1 0x99fa 0x929 0x70c 0x5ef2 0x997d 0x8bf 0x6ba 0x6102 0x9909 0x877 0x683 0x6312 0x989c 0x854 0x668 0x6523 0x983a 0x839 0x653 0x6733 0x97eb 0x834 0x64f 0x6944 0x9798 0x834 0x64f 0x6b54 0x974d 0x84c 0x662 0x6d64 0x970d 0x84d 0x663 0x6f75 0x96c5 0x84d 0x663 0x7185 0x968f 0x850 0x665 0x7395 0x9651 0x866 0x676 0x75a6 0x961c 0x86c 0x67a 0x77b6 0x95e7 0x886 0x68e 0x79c7 0x95b3 0x898 0x69c 0x7bd7 0x957e 0x898 0x69c 0x7de7 0x954d 0x898 0x69c 0x7ff8 0x9523 0x8b2 0x6b0 0x8208 0x94f9 0x8d8 0x6ce 0x8419 0x94cf 0x8f3 0x6e2 0x8629 0x94ab 0x91e 0x703 0x8839 0x9484 0x909 0x6f3 0x8a4a 0x945a 0x924 0x708 0x8c5a 0x9441 0x96f 0x742 0x8e6a 0x9422 0x9a7 0x76d 0x907b 0x9403 0x9c3 0x782 0x928b 0x93e3 0x9c6 0x785 0x949c 0x93cd 0x9f8 0x7ab 0x96ac 0x93b1 0xa1a 0x7c5 0x98bc 0x93a2 0xa64 0x7fe 0x9acd 0x9382 0xa92 0x822 0x9cdd 0x9366 0xabd 0x843 0x9eee 0x9349 0xaf9 0x871 0xa0fe 0x931f 0xb1e 0x88d 0xa30e 0x92f5 0xb5f 0x8bf 0xa51f 0x92ca 0xbbc 0x907 0xa72f 0x929a 0xc17 0x94d 0xa93f 0x925f 0xc76 0x996 0xab50 0x921f 0xd04 0xa03 0xad60 0x91d8 0xdc9 0xa9b 0xaf71 0x918e 0xeb1 0xb4d 0xb181 0x913b 0xf9e 0xc03 0xb391 0x90f0 0x10d3 0xcf1 0xb5a2 0x9092 0x117a 0xd72 0xb7b2 0x9034 0x14a8 0xfe4 0xb9c3 0x8feb 0x17e2 0x125f 0xbbd3 0x8faa 0x1dec 0x1704 0xbde3 0x8f5c 0x2c56 0x221b 0xbec2 0x8ef8 0x4b14 0x39c1 0xbec2 0x8e56 0x5267 0x3f63 0xbec2 0x8de0 0x5140 0x3e80 0xbec2 0x8de0 0x5140 0x3e80 0xbec2 0x8de0 0x5140 0x3e80 0xbec2 0x8de0 0x5140 0x3e80 0xbec2 0x8de0 0x5140 0x3e80>;
			battery0-profile-t4-num = <0x64>;
			battery0-profile-t4-col = <0x04>;
			battery0-profile-t4 = <0x00 0xae92 0x1bda 0x156d 0x210 0xad7a 0x1bd2 0x1566 0x421 0xacbf 0x1b98 0x153a 0x631 0xac24 0x1b2e 0x14e8 0x842 0xab9d 0x1ac4 0x1497 0xa52 0xab21 0x1a5b 0x1446 0xc62 0xaaad 0x19f9 0x13fb 0xe73 0xaa38 0x19aa 0x13be 0x1083 0xa9c9 0x195b 0x1381 0x1293 0xa95a 0x190c 0x1344 0x14a4 0xa8eb 0x18cb 0x1312 0x16b4 0xa87b 0x1886 0x12dd 0x18c5 0xa807 0x1837 0x12a0 0x1ad5 0xa793 0x17e8 0x1264 0x1ce5 0xa717 0x1798 0x1226 0x1ef6 0xa6a0 0x1749 0x11e9 0x2106 0xa62c 0x1727 0x11cf 0x2317 0xa5b8 0x16dd 0x1196 0x2527 0xa53a 0x168e 0x115a 0x2737 0xa4c5 0x1672 0x1144 0x2948 0xa447 0x1641 0x111e 0x2b58 0xa3d1 0x161d 0x1103 0x2d68 0xa355 0x15da 0x10cf 0x2f79 0xa2e0 0x15bf 0x10ba 0x3189 0xa269 0x159c 0x109f 0x339a 0xa1ee 0x1572 0x107f 0x35aa 0xa175 0x1557 0x106a 0x37ba 0xa0f6 0x1522 0x1042 0x39cb 0xa07d 0x14ff 0x1027 0x3bdb 0xa009 0x14ef 0x101a 0x3dec 0x9f95 0x14e6 0x1013 0x3ffc 0x9f20 0x14d3 0x1005 0x420c 0x9ea4 0x14b9 0xff1 0x441d 0x9e2e 0x149e 0xfdc 0x462d 0x9dba 0x149b 0xfda 0x483d 0x9d45 0x1482 0xfc6 0x4a4e 0x9cd1 0x144f 0xf9f 0x4c5e 0x9c52 0x1432 0xf89 0x4e6f 0x9bd5 0x1401 0xf63 0x507f 0x9b5e 0x13e7 0xf4f 0x528f 0x9ae2 0x13c5 0xf35 0x54a0 0x9a6e 0x1399 0xf13 0x56b0 0x99fe 0x137e 0xefe 0x58c1 0x998f 0x1364 0xeea 0x5ad1 0x9925 0x1356 0xee0 0x5ce1 0x98c1 0x133a 0xeca 0x5ef2 0x985d 0x1324 0xeb9 0x6102 0x9805 0x1324 0xeb9 0x6312 0x97b0 0x1324 0xeb9 0x6523 0x9763 0x1338 0xec9 0x6733 0x9719 0x1352 0xedd 0x6944 0x96d8 0x1356 0xee0 0x6b54 0x9699 0x11f1 0xdcd 0x6d64 0x9650 0x1388 0xf06 0x6f75 0x961a 0x13bd 0xf2f 0x7185 0x95dc 0x13ef 0xf55 0x7395 0x95a7 0x140e 0xf6d 0x75a6 0x9575 0x1449 0xf9b 0x77b6 0x9547 0x1489 0xfcc 0x79c7 0x9513 0x14b5 0xfee 0x7bd7 0x94e2 0x14fa 0x1023 0x7de7 0x94b7 0x153b 0x1055 0x7ff8 0x948d 0x157d 0x1088 0x8208 0x9469 0x15cf 0x10c7 0x8419 0x9449 0x1638 0x1117 0x8629 0x9429 0x16a2 0x1169 0x8839 0x940a 0x170c 0x11ba 0x8a4a 0x93fa 0x179e 0x122b 0x8c5a 0x93de 0x1827 0x1294 0x8e6a 0x93c8 0x18c2 0x130b 0x907b 0x93b3 0x1960 0x1385 0x928b 0x9393 0x19ff 0x13ff 0x949c 0x9374 0x1abd 0x1491 0x96ac 0x935e 0x1baa 0x1548 0x98bc 0x933e 0x1c9d 0x1603 0x9acd 0x931c 0x1da5 0x16ce 0x9cdd 0x92f5 0x1ec5 0x17ab 0x9eee 0x92cd 0x2026 0x18bb 0xa0fe 0x929d 0x21ad 0x19e8 0xa30e 0x926e 0x2360 0x1b36 0xa51f 0x9234 0x254a 0x1caf 0xa72f 0x91fa 0x27a5 0x1e7f 0xa93f 0x91b8 0x2a6a 0x20a0 0xab50 0x9175 0x2dee 0x2355 0xad60 0x9127 0x326d 0x26ca 0xaf71 0x90d2 0x3907 0x2bde 0xb181 0x9086 0x43ae 0x3410 0xb391 0x9030 0x569d 0x42a0 0xb5a2 0x8fd8 0x562c 0x4249 0xb7b2 0x8f84 0x555a 0x41a8 0xb88a 0x8f52 0x54dd 0x4148 0xb88a 0x8f52 0x54dd 0x4148 0xb88a 0x8f52 0x54dd 0x4148 0xb88a 0x8f52 0x54dd 0x4148 0xb88a 0x8f52 0x54dd 0x4148 0xb88a 0x8f52 0x54dd 0x4148 0xb88a 0x8f52 0x54dd 0x4148 0xb88a 0x8f52 0x54dd 0x4148 0xb88a 0x8f52 0x54dd 0x4148 0xb88a 0x8f52 0x54dd 0x4148>;
			battery3-profile-t0-num = <0x64>;
			battery3-profile-t0-col = <0x04>;
			battery3-profile-t0 = <0x00 0xafe6 0x1e0 0x15f 0x213 0xaebf 0x1e1 0x160 0x426 0xadaf 0x1f8 0x172 0x638 0xace6 0x202 0x178 0x84b 0xac4a 0x208 0x17d 0xa5e 0xabc5 0x203 0x179 0xc71 0xab47 0x1f5 0x16f 0xe84 0xaad0 0x1f0 0x16c 0x1096 0xaa5d 0x1f4 0x16f 0x12a9 0xa9ea 0x1f4 0x16f 0x14bc 0xa974 0x1f0 0x16c 0x16cf 0xa8fe 0x1f1 0x16c 0x18e2 0xa888 0x1f0 0x16c 0x1af5 0xa80f 0x1ef 0x16b 0x1d07 0xa796 0x1f1 0x16c 0x1f1a 0xa719 0x1f8 0x172 0x212d 0xa699 0x1f9 0x172 0x2340 0xa61c 0x1f7 0x171 0x2553 0xa59b 0x1f6 0x170 0x2765 0xa51b 0x1f7 0x171 0x2978 0xa49b 0x1f8 0x172 0x2b8b 0xa41e 0x1ff 0x176 0x2d9e 0xa3a2 0x201 0x178 0x2fb1 0xa325 0x201 0x178 0x31c3 0xa2a9 0x1ff 0x176 0x33d6 0xa22f 0x203 0x179 0x35e9 0xa1b8 0x20c 0x180 0x37fc 0xa13f 0x209 0x17e 0x3a0f 0xa0c7 0x207 0x17c 0x3c21 0xa055 0x20c 0x180 0x3e34 0x9fe3 0x20f 0x182 0x4047 0x9f76 0x216 0x187 0x425a 0x9f06 0x217 0x188 0x446d 0x9e9d 0x226 0x193 0x467f 0x9e31 0x21f 0x18e 0x4892 0x9dcb 0x227 0x194 0x4aa5 0x9d66 0x22f 0x19a 0x4cb8 0x9d04 0x237 0x19f 0x4ecb 0x9ca6 0x242 0x1a8 0x50de 0x9c49 0x24e 0x1b0 0x52f0 0x9bec 0x258 0x1b8 0x5503 0x9b92 0x265 0x1c2 0x5716 0x9b39 0x276 0x1ce 0x5929 0x9adf 0x28a 0x1dc 0x5b3c 0x9a76 0x295 0x1e4 0x5d4e 0x99df 0x256 0x1b6 0x5f61 0x9938 0x219 0x189 0x6174 0x98bf 0x209 0x17e 0x6387 0x9860 0x1fa 0x172 0x659a 0x9813 0x1f9 0x172 0x67ac 0x97ca 0x1f6 0x170 0x69bf 0x9788 0x1f6 0x170 0x6bd2 0x9747 0x1f0 0x16c 0x6de5 0x970b 0x1fb 0x173 0x6ff8 0x96d3 0x200 0x177 0x720a 0x969c 0x201 0x178 0x741d 0x9666 0x205 0x17b 0x7630 0x9631 0x1ff 0x176 0x7843 0x9600 0x1ff 0x176 0x7a56 0x95d0 0x203 0x179 0x7c68 0x95a2 0x207 0x17c 0x7e7b 0x9577 0x20d 0x181 0x808e 0x954e 0x215 0x186 0x82a1 0x9526 0x217 0x188 0x84b4 0x9502 0x224 0x192 0x86c7 0x94db 0x226 0x193 0x88d9 0x94b7 0x22d 0x198 0x8aec 0x9496 0x236 0x19e 0x8cff 0x9478 0x246 0x1ab 0x8f12 0x9455 0x254 0x1b4 0x9125 0x9426 0x243 0x1a8 0x9337 0x93dd 0x214 0x186 0x954a 0x9382 0x1fb 0x173 0x975d 0x9338 0x202 0x178 0x9970 0x9302 0x208 0x17d 0x9b83 0x92cc 0x207 0x17c 0x9d95 0x9296 0x207 0x17c 0x9fa8 0x9261 0x203 0x179 0xa1bb 0x9233 0x206 0x17b 0xa3ce 0x920b 0x20e 0x182 0xa5e1 0x91de 0x209 0x17e 0xa7f3 0x91ae 0x20f 0x182 0xaa06 0x9171 0x208 0x17d 0xac19 0x9122 0x1fe 0x175 0xae2c 0x90e3 0x205 0x17b 0xb03f 0x909f 0x205 0x17b 0xb251 0x9049 0x200 0x177 0xb464 0x900a 0x1ff 0x176 0xb677 0x8ff9 0x205 0x17b 0xb88a 0x8fea 0x214 0x186 0xba9d 0x8fd9 0x222 0x190 0xbb20 0x8fbd 0x226 0x193 0xbc06 0x8f82 0x226 0x193 0xbd51 0x8ebd 0x226 0x193 0xbf00 0x8d22 0x22d 0x198 0xc113 0x8ad5 0x250 0x1b1 0xc2c2 0x87b7 0x2a2 0x1ed 0xc72c 0x8311 0x36f 0x284 0xcb33 0x7aee 0xf0e 0xb08 0xcd46 0x7163 0x2cbf 0x20c8>;
			battery3-profile-t1-num = <0x64>;
			battery3-profile-t1-col = <0x04>;
			battery3-profile-t1 = <0x00 0xb093 0x37a 0x28c 0x213 0xafa5 0x37a 0x28c 0x426 0xae6e 0x37c 0x28d 0x638 0xad79 0x372 0x286 0x84b 0xacc7 0x360 0x279 0xa5e 0xac39 0x350 0x26d 0xc71 0xabbc 0x340 0x262 0xe84 0xab48 0x336 0x25a 0x1096 0xaad7 0x332 0x257 0x12a9 0xaa67 0x32e 0x254 0x14bc 0xa9f9 0x32e 0x254 0x16cf 0xa987 0x328 0x250 0x18e2 0xa914 0x325 0x24e 0x1af5 0xa89d 0x321 0x24b 0x1d07 0xa823 0x31e 0x249 0x1f1a 0xa7a9 0x31d 0x248 0x212d 0xa72d 0x320 0x24a 0x2340 0xa6aa 0x307 0x238 0x2553 0xa62d 0x2f8 0x22d 0x2765 0xa5ad 0x2f9 0x22d 0x2978 0xa52c 0x301 0x234 0x2b8b 0xa4ab 0x301 0x234 0x2d9e 0xa42b 0x2f5 0x22a 0x2fb1 0xa3ae 0x2ff 0x232 0x31c3 0xa330 0x2ff 0x232 0x33d6 0xa2b5 0x303 0x235 0x35e9 0xa23a 0x307 0x238 0x37fc 0xa1be 0x307 0x238 0x3a0f 0xa149 0x311 0x23f 0x3c21 0xa0d3 0x316 0x243 0x3e34 0xa05d 0x318 0x244 0x4047 0x9fec 0x31d 0x248 0x425a 0x9f7c 0x32e 0x254 0x446d 0x9f0c 0x334 0x259 0x467f 0x9ea2 0x33e 0x260 0x4892 0x9e36 0x346 0x266 0x4aa5 0x9dce 0x351 0x26e 0x4cb8 0x9d6b 0x368 0x27f 0x4ecb 0x9d07 0x372 0x286 0x50de 0x9ca7 0x382 0x292 0x52f0 0x9c49 0x395 0x29f 0x5503 0x9bed 0x3a9 0x2af 0x5716 0x9b92 0x3c1 0x2c0 0x5929 0x9b37 0x3d5 0x2cf 0x5b3c 0x9ad8 0x3e8 0x2dc 0x5d4e 0x9a69 0x3df 0x2d6 0x5f61 0x99dc 0x3a2 0x2a9 0x6174 0x993a 0x33e 0x260 0x6387 0x98b4 0x2fd 0x230 0x659a 0x984f 0x2e9 0x222 0x67ac 0x97f9 0x2d8 0x215 0x69bf 0x97b1 0x2e2 0x21d 0x6bd2 0x976f 0x2e2 0x21d 0x6de5 0x972c 0x2e2 0x21d 0x6ff8 0x96f1 0x2e1 0x21c 0x720a 0x96b6 0x2e1 0x21c 0x741d 0x9680 0x2e5 0x21f 0x7630 0x964b 0x2e4 0x21e 0x7843 0x9618 0x2e8 0x221 0x7a56 0x95e9 0x2ec 0x224 0x7c68 0x95ba 0x2eb 0x224 0x7e7b 0x958c 0x2e7 0x221 0x808e 0x9563 0x2f4 0x22a 0x82a1 0x953b 0x2f8 0x22d 0x84b4 0x9517 0x2ff 0x232 0x86c7 0x94f3 0x307 0x238 0x88d9 0x94cf 0x307 0x238 0x8aec 0x94ae 0x317 0x243 0x8cff 0x9490 0x320 0x24a 0x8f12 0x9473 0x330 0x256 0x9125 0x9453 0x335 0x25a 0x9337 0x9430 0x331 0x256 0x954a 0x940d 0x331 0x256 0x975d 0x93e1 0x319 0x245 0x9970 0x93b0 0x2ff 0x232 0x9b83 0x937e 0x2f4 0x22a 0x9d95 0x934d 0x2f1 0x227 0x9fa8 0x931a 0x2eb 0x224 0xa1bb 0x92e7 0x2e9 0x222 0xa3ce 0x92bb 0x2e7 0x221 0xa5e1 0x9295 0x2ef 0x226 0xa7f3 0x9271 0x2f8 0x22d 0xaa06 0x9241 0x2f1 0x227 0xac19 0x9205 0x2f8 0x22d 0xae2c 0x91c1 0x2f1 0x227 0xb03f 0x9180 0x2f9 0x22d 0xb251 0x9142 0x301 0x234 0xb464 0x90f2 0x302 0x234 0xb677 0x909f 0x2f5 0x22a 0xb88a 0x9079 0x2f7 0x22c 0xba9d 0x9068 0x303 0x235 0xbb84 0x9054 0x30b 0x23a 0xbcce 0x903b 0x319 0x245 0xbdb5 0x9018 0x328 0x250 0xc2e8 0x8fbf 0x327 0x24f 0xbfe7 0x8e98 0x319 0x245 0xc196 0x8c98 0x336 0x25a 0xc2e0 0x89d9 0x375 0x289 0xc363 0x85e1 0x3ed 0x2e0 0xc95e 0x7f5c 0x607 0x46a>;
			battery3-profile-t2-num = <0x64>;
			battery3-profile-t2-col = <0x04>;
			battery3-profile-t2 = <0x00 0xb0ce 0x88d 0x5fb 0x213 0xafe5 0x88c 0x5fa 0x426 0xaea7 0x878 0x5ec 0x638 0xad8e 0x83b 0x5c1 0x84b 0xaccd 0x80f 0x5a2 0xa5e 0xac3a 0x7e4 0x584 0xc71 0xabbc 0x7b5 0x564 0xe84 0xab48 0x797 0x54e 0x1096 0xaad8 0x776 0x537 0x12a9 0xaa68 0x75a 0x524 0x14bc 0xa9f7 0x740 0x512 0x16cf 0xa985 0x728 0x501 0x18e2 0xa915 0x721 0x4fc 0x1af5 0xa89d 0x705 0x4e9 0x1d07 0xa82b 0x705 0x4e9 0x1f1a 0xa7b3 0x6ef 0x4da 0x212d 0xa736 0x6d5 0x4c7 0x2340 0xa6bc 0x6c9 0x4bf 0x2553 0xa63b 0x6b7 0x4b2 0x2765 0xa5bb 0x6ab 0x4aa 0x2978 0xa53c 0x6b0 0x4ad 0x2b8b 0xa4be 0x69e 0x4a1 0x2d9e 0xa43d 0x699 0x49d 0x2fb1 0xa3be 0x695 0x49a 0x31c3 0xa341 0x68f 0x496 0x33d6 0xa2c6 0x693 0x499 0x35e9 0xa249 0x68f 0x496 0x37fc 0xa1ce 0x68e 0x495 0x3a0f 0xa157 0x694 0x49a 0x3c21 0xa0df 0x69e 0x4a1 0x3e34 0xa06a 0x6a8 0x4a8 0x4047 0x9ff4 0x6a9 0x4a8 0x425a 0x9f83 0x6ba 0x4b4 0x446d 0x9f11 0x6bd 0x4b6 0x467f 0x9ea3 0x6cb 0x4c0 0x4892 0x9e35 0x6d7 0x4c9 0x4aa5 0x9dcb 0x6e9 0x4d5 0x4cb8 0x9d60 0x6f8 0x4e0 0x4ecb 0x9cfa 0x70f 0x4f0 0x50de 0x9c98 0x72c 0x504 0x52f0 0x9c3a 0x745 0x516 0x5503 0x9bda 0x74f 0x51c 0x5716 0x9b77 0x75a 0x524 0x5929 0x9b0e 0x752 0x51f 0x5b3c 0x9a9d 0x740 0x512 0x5d4e 0x9a23 0x707 0x4ea 0x5f61 0x9999 0x6b0 0x4ad 0x6174 0x9914 0x655 0x46e 0x6387 0x989c 0x612 0x43f 0x659a 0x9838 0x5ff 0x431 0x67ac 0x97dd 0x5db 0x418 0x69bf 0x9792 0x5de 0x41a 0x6bd2 0x974a 0x5dc 0x419 0x6de5 0x9707 0x5d7 0x415 0x6ff8 0x96c9 0x5de 0x41a 0x720a 0x968e 0x5de 0x41a 0x741d 0x9654 0x5e0 0x41c 0x7630 0x961e 0x5e9 0x422 0x7843 0x95eb 0x5f2 0x429 0x7a56 0x95b9 0x5fb 0x42f 0x7c68 0x9588 0x5ff 0x431 0x7e7b 0x9559 0x60b 0x43a 0x808e 0x952e 0x625 0x44c 0x82a1 0x9503 0x62f 0x453 0x84b4 0x94db 0x63a 0x45b 0x86c7 0x94bc 0x65c 0x472 0x88d9 0x9495 0x64d 0x468 0x8aec 0x9475 0x65e 0x474 0x8cff 0x9457 0x670 0x480 0x8f12 0x9439 0x67f 0x48b 0x9125 0x941c 0x688 0x491 0x9337 0x93ff 0x692 0x498 0x954a 0x93e1 0x697 0x49c 0x975d 0x93c2 0x69f 0x4a1 0x9970 0x93a6 0x6a9 0x4a8 0x9b83 0x9386 0x6a9 0x4a8 0x9d95 0x9362 0x6ab 0x4aa 0x9fa8 0x9335 0x69e 0x4a1 0xa1bb 0x9303 0x699 0x49d 0xa3ce 0x92d3 0x69f 0x4a1 0xa5e1 0x92a8 0x6a8 0x4a8 0xa7f3 0x927e 0x6c3 0x4bb 0xaa06 0x924c 0x6e6 0x4d3 0xac19 0x9209 0x6f8 0x4e0 0xae2c 0x91bf 0x717 0x4f5 0xb03f 0x9179 0x741 0x512 0xb251 0x912b 0x76c 0x530 0xb464 0x90d4 0x7ac 0x55d 0xb677 0x907a 0x7ee 0x58b 0xb88a 0x903b 0x847 0x5ca 0xba9d 0x9015 0x8d6 0x62e 0xbcb0 0x8ff1 0x9b8 0x6cc 0xbec2 0x8fbe 0xb39 0x7d9 0xc0d5 0x8f6f 0xdfb 0x9c7 0xc2e8 0x8ee4 0x13d0 0xddb 0xc4fb 0x8d9b 0x244e 0x1963 0xc70e 0x8b1d 0x6cff 0x4c38 0xc920 0x8ac8 0x7764 0x537d 0xcb33 0x8ac8 0x7764 0x537d 0xcd46 0x8ac8 0x7764 0x537d>;
			battery3-profile-t3-num = <0x64>;
			battery3-profile-t3-col = <0x04>;
			battery3-profile-t3 = <0x00 0xb097 0xcc1 0x8eb 0x213 0xaf45 0xcbf 0x8ea 0x426 0xadeb 0xc96 0x8cd 0x638 0xacfa 0xc46 0x895 0x84b 0xac4f 0xc04 0x867 0xa5e 0xabca 0xbd7 0x847 0xc71 0xab51 0xba3 0x823 0xe84 0xaadf 0xb6c 0x7fd 0x1096 0xaa72 0xb46 0x7e2 0x12a9 0xaa02 0xb1f 0x7c7 0x14bc 0xa993 0xaf1 0x7a6 0x16cf 0xa922 0xac6 0x788 0x18e2 0xa8ac 0xaa6 0x772 0x1af5 0xa836 0xa8b 0x760 0x1d07 0xa7ba 0xa5a 0x73d 0x1f1a 0xa740 0xa44 0x72e 0x212d 0xa6c3 0xa27 0x71a 0x2340 0xa642 0xa05 0x702 0x2553 0xa5c2 0x9fb 0x6fb 0x2765 0xa545 0x9e8 0x6ed 0x2978 0xa4c3 0x9ca 0x6d8 0x2b8b 0xa444 0x9be 0x6d0 0x2d9e 0xa3c4 0x9ad 0x6c4 0x2fb1 0xa345 0x9a9 0x6c1 0x31c3 0xa2c8 0x9a9 0x6c1 0x33d6 0xa24b 0x99f 0x6ba 0x35e9 0xa1d0 0x99d 0x6b9 0x37fc 0xa156 0x99b 0x6b7 0x3a0f 0xa0de 0x9ac 0x6c4 0x3c21 0xa066 0x9b2 0x6c7 0x3e34 0x9ff1 0x9bf 0x6d1 0x4047 0x9f7b 0x9bc 0x6ce 0x425a 0x9f0d 0x9d9 0x6e3 0x446d 0x9e9d 0x9dd 0x6e5 0x467f 0x9e2a 0x9e4 0x6eb 0x4892 0x9dbf 0x9f9 0x6f9 0x4aa5 0x9d55 0xa10 0x70a 0x4cb8 0x9ceb 0xa1a 0x710 0x4ecb 0x9c80 0xa22 0x716 0x50de 0x9c19 0xa2c 0x71d 0x52f0 0x9baf 0xa2e 0x71e 0x5503 0x9b42 0xa25 0x718 0x5716 0x9ad2 0xa07 0x703 0x5929 0x9a58 0x9ce 0x6db 0x5b3c 0x99d7 0x988 0x6aa 0x5d4e 0x9958 0x945 0x67b 0x5f61 0x98e0 0x90e 0x655 0x6174 0x9872 0x8de 0x634 0x6387 0x9812 0x8c5 0x622 0x659a 0x97bc 0x8b9 0x61a 0x67ac 0x976d 0x8bb 0x61b 0x69bf 0x9722 0x8b2 0x615 0x6bd2 0x96e1 0x8bc 0x61c 0x6de5 0x96a2 0x8ca 0x625 0x6ff8 0x9665 0x8cd 0x627 0x720a 0x962b 0x8db 0x631 0x741d 0x95f4 0x8f0 0x640 0x7630 0x95c0 0x902 0x64c 0x7843 0x958d 0x910 0x656 0x7a56 0x955e 0x928 0x667 0x7c68 0x952f 0x93c 0x675 0x7e7b 0x9504 0x94f 0x682 0x808e 0x94dc 0x971 0x69a 0x82a1 0x94b2 0x97e 0x6a3 0x84b4 0x948d 0x996 0x6b4 0x86c7 0x9468 0x9a0 0x6bb 0x88d9 0x9447 0x9c3 0x6d4 0x8aec 0x942a 0x9df 0x6e7 0x8cff 0x940a 0x9f1 0x6f4 0x8f12 0x93ef 0xa0d 0x707 0x9125 0x93d3 0xa2a 0x71b 0x9337 0x93bc 0xa43 0x72d 0x954a 0x93a5 0xa69 0x748 0x975d 0x938b 0xa8f 0x762 0x9970 0x936d 0xaaf 0x778 0x9b83 0x934e 0xae1 0x79c 0x9d95 0x9325 0xb08 0x7b7 0x9fa8 0x92f4 0xb2f 0x7d2 0xa1bb 0x92c5 0xb6b 0x7fc 0xa3ce 0x9292 0xbb0 0x82c 0xa5e1 0x925f 0xc16 0x874 0xa7f3 0x9223 0xc85 0x8c2 0xaa06 0x91d9 0xd0d 0x920 0xac19 0x9187 0xdad 0x990 0xae2c 0x9138 0xe86 0xa28 0xb03f 0x90e6 0xf9c 0xaeb 0xb251 0x9086 0x1100 0xbe3 0xb464 0x9025 0x12d1 0xd28 0xb677 0x8fda 0x158d 0xf12 0xb88a 0x8f98 0x1a07 0x1233 0xba9d 0x8f4f 0x2299 0x1832 0xbcb0 0x8ef5 0x3b28 0x295e 0xbec2 0x8ed0 0x47ee 0x324d 0xbec2 0x8ed0 0x47ee 0x324d 0xbec2 0x8ed0 0x47ee 0x324d 0xbec2 0x8ed0 0x47ee 0x324d 0xbec2 0x8ed0 0x47ee 0x324d 0xbec2 0x8ed0 0x47ee 0x324d 0xbec2 0x8ed0 0x47ee 0x324d 0xbec2 0x8ed0 0x47ee 0x324d>;
			battery3-profile-t4-num = <0x64>;
			battery3-profile-t4-col = <0x04>;
			battery3-profile-t4 = <0x00 0xb0c5 0x1c19 0x159d 0x213 0xaf4f 0x1c15 0x159a 0x426 0xadc3 0x1bd7 0x156a 0x638 0xaca7 0x1b7b 0x1524 0x84b 0xabdc 0x1b1b 0x14da 0xa5e 0xab3b 0x1ab7 0x148d 0xc71 0xaaad 0x1a41 0x1432 0xe84 0xaa2c 0x19e0 0x13e7 0x1096 0xa9b2 0x198b 0x13a6 0x12a9 0xa939 0x1934 0x1363 0x14bc 0xa8c1 0x18eb 0x132b 0x16cf 0xa84b 0x18b0 0x12fe 0x18e2 0xa7d4 0x1876 0x12d1 0x1af5 0xa75e 0x1850 0x12b4 0x1d07 0xa6e5 0x1827 0x1294 0x1f1a 0xa66b 0x1804 0x1279 0x212d 0xa5ee 0x17d5 0x1255 0x2340 0xa574 0x17b4 0x123c 0x2553 0xa4fa 0x178a 0x121b 0x2765 0xa47e 0x1764 0x11fe 0x2978 0xa406 0x174f 0x11ee 0x2b8b 0xa38a 0x1728 0x11d0 0x2d9e 0xa310 0x1707 0x11b7 0x2fb1 0xa295 0x16ec 0x11a2 0x31c3 0xa21b 0x16e3 0x119b 0x33d6 0xa1a3 0x16d3 0x118f 0x35e9 0xa129 0x16e9 0x11a0 0x37fc 0xa0ad 0x1726 0x11ce 0x3a0f 0xa035 0x173e 0x11e1 0x3c21 0x9fbb 0x1733 0x11d8 0x3e34 0x9f47 0x1737 0x11dc 0x4047 0x9ed1 0x16fa 0x11ad 0x425a 0x9e5e 0x16cf 0x118c 0x446d 0x9dea 0x169d 0x1165 0x467f 0x9d75 0x1676 0x1147 0x4892 0x9d04 0x1654 0x112d 0x4aa5 0x9c91 0x1630 0x1111 0x4cb8 0x9c1d 0x15fe 0x10eb 0x4ecb 0x9ba7 0x15d8 0x10ce 0x50de 0x9b2f 0x15c9 0x10c2 0x52f0 0x9ab8 0x15c1 0x10bc 0x5503 0x9a43 0x15ac 0x10ac 0x5716 0x99d0 0x1587 0x108f 0x5929 0x9962 0x1562 0x1073 0x5b3c 0x98f7 0x153c 0x1056 0x5d4e 0x9893 0x1526 0x1045 0x5f61 0x9833 0x1514 0x1037 0x6174 0x97d9 0x1520 0x1040 0x6387 0x9786 0x1530 0x104c 0x659a 0x9734 0x1543 0x105b 0x67ac 0x96eb 0x155f 0x1070 0x69bf 0x96a4 0x157c 0x1087 0x6bd2 0x9662 0x15e3 0x10d6 0x6de5 0x9621 0x164d 0x1128 0x6ff8 0x95e4 0x168d 0x1159 0x720a 0x95ad 0x16cd 0x118a 0x741d 0x9577 0x16e7 0x119e 0x7630 0x9544 0x16ec 0x11a2 0x7843 0x9515 0x16f8 0x11ab 0x7a56 0x94ea 0x171b 0x11c6 0x7c68 0x94c4 0x174e 0x11ed 0x7e7b 0x949b 0x1777 0x120d 0x808e 0x947a 0x17b1 0x1239 0x82a1 0x945d 0x17fa 0x1272 0x84b4 0x9445 0x1867 0x12c5 0x86c7 0x9427 0x18aa 0x12f9 0x88d9 0x9411 0x1920 0x1354 0x8aec 0x93f6 0x19bb 0x13cb 0x8cff 0x93dc 0x1a43 0x1434 0x8f12 0x93c4 0x1ad6 0x14a5 0x9125 0x93aa 0x1b5c 0x150c 0x9337 0x938d 0x1bfb 0x1586 0x954a 0x9370 0x1cc7 0x1623 0x975d 0x934f 0x1dcd 0x16ec 0x9970 0x932d 0x1ed5 0x17b8 0x9b83 0x9307 0x1fec 0x188e 0x9d95 0x92df 0x2114 0x1972 0x9fa8 0x92b3 0x2251 0x1a66 0xa1bb 0x9285 0x2401 0x1bb2 0xa3ce 0x924f 0x25a8 0x1cf7 0xa5e1 0x9217 0x279f 0x1e7a 0xa7f3 0x91db 0x29ba 0x2019 0xaa06 0x9194 0x2c03 0x21db 0xac19 0x914b 0x2e8f 0x23d0 0xae2c 0x90ff 0x31f1 0x266b 0xb03f 0x90b1 0x368b 0x29f5 0xb251 0x905a 0x3cf0 0x2ee0 0xb464 0x8ffd 0x4684 0x363e 0xb677 0x8fac 0x5791 0x435c 0xb88a 0x8f84 0x6520 0x4dca 0xb88a 0x8f84 0x6520 0x4dca 0xb88a 0x8f84 0x6520 0x4dca 0xb88a 0x8f84 0x6520 0x4dca 0xb88a 0x8f84 0x6520 0x4dca 0xb88a 0x8f84 0x6520 0x4dca 0xb88a 0x8f84 0x6520 0x4dca 0xb88a 0x8f84 0x6520 0x4dca 0xb88a 0x8f84 0x6520 0x4dca 0xb88a 0x8f84 0x6520 0x4dca 0xb88a 0x8f84 0x6520 0x4dca>;
			g-pmic-min-vol-row = <0x04>;
			g-pmic-min-vol-col = <0x0a>;
			g-pmic-min-vol = <0x8534 0x82dc 0x8660 0x8534 0x8534 0x80e8 0x8660 0x8534 0x80e8 0x80e8 0x8660 0x80e8 0x7ef4 0x7dc8 0x8660 0x7ef4 0x7d00 0x7918 0x8660 0x7d00 0x7b0c 0x7b0c 0x7b0c 0x7b0c 0x7918 0x7918 0x7918 0x7918 0x7918 0x7918 0x7918 0x7918 0x7918 0x7918 0x7918 0x7918 0x7918 0x7918 0x7918 0x79e0>;
			g-pon-sys-iboot-row = <0x04>;
			g-pon-sys-iboot-col = <0x0a>;
			g-pon-sys-iboot = <0x1388 0x1388 0x1388 0x1388 0x1388 0x1388 0x1388 0x1388 0x1388 0x1388 0x1388 0x1388 0x1388 0x1388 0x1388 0x1388 0x1388 0x1388 0x1388 0x1388 0x1388 0x1388 0x1388 0x1388 0x1388 0x1388 0x1388 0x1388 0x1388 0x1388 0x1388 0x1388 0x1388 0x1388 0x1388 0x1388 0x1388 0x1388 0x1388 0x1388>;
			g-qmax-sys-vol-row = <0x04>;
			g-qmax-sys-vol-col = <0x0a>;
			g-qmax-sys-vol = <0x85ca 0x85ca 0x85ca 0x85ca 0x85ca 0x85ca 0x85ca 0x85ca 0x811a 0x85ca 0x85ca 0x811a 0x7f26 0x85ca 0x85ca 0x7f26 0x7d32 0x85ca 0x85ca 0x7d32 0x7ef4 0x7ef4 0x7ef4 0x85ca 0x8020 0x8020 0x8020 0x85ca 0x8020 0x8020 0x8020 0x85ca 0x8020 0x8020 0x8020 0x85ca 0x8020 0x8020 0x8020 0x85ca>;
			g-fg-pseudo100-row = <0x04>;
			g-fg-pseudo100-col = <0x0a>;
			g-fg-pseudo100 = <0x61 0x61 0x61 0x61 0x61 0x61 0x61 0x61 0x61 0x61 0x61 0x61 0x5f 0x5f 0x5f 0x5f 0x5f 0x5f 0x5f 0x5f 0x5f 0x5f 0x5f 0x5f 0x5f 0x5f 0x5f 0x5f 0x5f 0x5f 0x5f 0x5f 0x5f 0x5f 0x5f 0x5f 0x5f 0x5f 0x5f 0x5f>;
			g-fg-charge-pseudo100-row = <0x04>;
			g-fg-charge-pseudo100-col = <0x0a>;
			g-fg-charge-pseudo100 = <0x61 0x61 0x61 0x61 0x61 0x61 0x61 0x61 0x61 0x61 0x61 0x61 0x5f 0x5f 0x5f 0x5f 0x5f 0x5f 0x5f 0x5f 0x5f 0x5f 0x5f 0x5f 0x5f 0x5f 0x5f 0x5f 0x5f 0x5f 0x5f 0x5f 0x5f 0x5f 0x5f 0x5f 0x5f 0x5f 0x5f 0x5f>;
		};
	};

	fragment@19 {
		target = <0xffffffff>;

		__overlay__ {
			#address-cells = <0x01>;
			#size-cells = <0x00>;
			clock-frequency = <0x186a0>;

			sc8548_master@6F {
				compatible = "sc,sc8548-standalone";
				chg_name = "primary_dvchg";
				reg = <0x6f>;
				sc8548,intr-gpios = <0xffffffff 0x00 0x00>;
				sc,sc8548,bat-ovp-threshold = <0x11ad>;
				sc,sc8548,bat-ocp-threshold = <0x32c8>;
				sc,sc8548,ac-ovp-threshold = <0x2ee0>;
				sc,sc8548,bus-ovp-threshold = <0x2ee0>;
				sc,sc8548,bus-ocp-threshold = <0x1388>;
				sc,sc8548,sense-resistor-mohm = <0x05>;
				set_vil;
			};
		};
	};

	fragment@20 {
		target = <0xffffffff>;

		__overlay__ {
			#address-cells = <0x01>;
			#size-cells = <0x00>;

			hl7139a_master@5f {
				compatible = "richtek,hl7139a";
				status = "okay";
				reg = <0x5f>;
				rm_name = "hl7139a";
				rm_slave_addr = [5f];
				hl7139a,intr-gpios = <0xffffffff 0x00 0x00>;

				standalone {
					chg_name = "primary_dvchg";
					eft_enable;
					vbatovp = <0x456d70>;
					ibatocp = <0x8339c0>;
					vbusovp = <0xa7d8c0>;
					ibusocp = <0x419ce0>;
					vinovp = <0xa7d8c0>;
					wdt = <0x2625a00>;
					ibat_rsense = <0x00>;
					i2c_vil_up = <0x01>;
					lt_wd_tmr = <0x03>;
					gpp_conf = <0x00>;
					fsw_val = <0x03>;
					protocol_i_masked;
					vbat_reg_dis;
					ibat_reg_dis;
					iin_reg_dis;
					tdie_reg_dis;
					ibatocp_dis;
				};
			};
		};
	};

	fragment@21 {
		target = <0xffffffff>;

		__overlay__ {

			usb_control {
				compatible = "transsion, usb_control";
				status = "okay";
				tc30_control_type = <0x04>;
				hvdcp20_control_type = <0x01>;
				rfc_control_type = <0x01>;
				ta_control_type = <0x00>;
				hvdcp20_pull_down_dp;
				pinctrl-names = "default\0hvdcp_handshake\0hvdcp_boost_5v\0hvdcp_boost_9v\0hvdcp_reset\0tc30_handshake\0tc30_reset\0rfc_i2c_mode\0rfc_dual_high\0rfc_high_low\0rfc_reset\0rfc_usb_switch_on\0rfc_usb_switch_off\0ta_off\0ta_reset";
				pinctrl-0 = <0x11>;
				pinctrl-1 = <0x12>;
				pinctrl-2 = <0x13>;
				pinctrl-3 = <0x14>;
				pinctrl-4 = <0x15>;
				pinctrl-5 = <0x16>;
				pinctrl-6 = <0x17>;
				pinctrl-7 = <0x18>;
				pinctrl-8 = <0x19>;
				pinctrl-9 = <0x1a>;
				pinctrl-10 = <0x1b>;
				pinctrl-11 = <0x1c>;
				pinctrl-12 = <0x1d>;
				pinctrl-13 = <0x1e>;
				pinctrl-14 = <0x1f>;
				phandle = <0x48>;
			};
		};
	};

	fragment@22 {
		target = <0xffffffff>;

		__overlay__ {

			usb_control_default {
				phandle = <0x11>;
			};

			hvdcp_handshake {
				phandle = <0x12>;
			};

			hvdcp_boost_5v {
				phandle = <0x13>;
			};

			hvdcp_boost_9v {
				phandle = <0x14>;
			};

			hvdcp_reset {
				phandle = <0x15>;
			};

			tc30_handshake {
				phandle = <0x16>;
			};

			tc30_reset {
				phandle = <0x17>;
			};

			rfc_i2c_mode {
				phandle = <0x18>;
			};

			rfc_dual_high {
				phandle = <0x19>;
			};

			rfc_high_low {
				phandle = <0x1a>;
			};

			rfc_reset {
				phandle = <0x1b>;
			};

			usb_switch_on {
				phandle = <0x1c>;
			};

			usb_switch_off {
				phandle = <0x1d>;
			};

			ta_off {
				phandle = <0x1e>;
			};

			ta_reset {
				phandle = <0x1f>;
			};
		};
	};

	fragment@23 {
		target = <0xffffffff>;

		__overlay__ {
			compatible = "tc_pe5";
			status = "okay";
			tc_chgtype = <0x20>;
			polling_interval = <0x1f4>;
			ta_cv_ss_repeat_tmin = <0x19>;
			vbat_cv = <0x11d0>;
			start_vbat_min = <0xcf8>;
			start_vbat_max = <0x1162>;
			idvchg_term = <0x28a>;
			idvchg_pps_term = <0x4b0>;
			rcable_level = <0x12c 0x15e 0x1c2 0x226>;
			ita_level = <0xfa0 0x8ca 0x7d0 0x5dc>;
			idvchg_level_multi = <0xfa0 0x1b58 0x1b58 0x1b58>;
			idvchg_ss_init = <0x3e8>;
			idvchg_ss_step = <0xfa>;
			idvchg_ss_step1 = <0x64>;
			idvchg_ss_step2 = <0x32>;
			idvchg_ss_step1_vbat = <0xfa0>;
			idvchg_ss_step2_vbat = <0x1068>;
			ta_blanking = <0x190>;
			chg_time_max = <0x8ca0>;
			tta_level_def = <0x00 0x00 0x00 0x05 0x19 0x19 0x19 0x19 0x19 0x19 0x19 0x19 0x19 0x50 0x55 0x5a 0x5f>;
			tta_curlmt = <0xffffffff 0xffffffff 0xffffffff 0x00 0x00 0x00 0x00 0x00 0x00 0x00 0x00 0x00 0x00 0x12c 0x258 0x384 0xffffffff>;
			tta_recovery_area = <0x01>;
			tdvchg_level_def = <0x00 0x00 0x00 0x05 0x19 0x19 0x19 0x19 0x19 0x19 0x19 0x19 0x19 0x46 0x4b 0x50 0x55>;
			tdvchg_curlmt = <0xffffffff 0xffffffff 0xffffffff 0x00 0x00 0x00 0x00 0x00 0x00 0x00 0x00 0x00 0x00 0x12c 0x258 0x384 0xffffffff>;
			tdvchg_recovery_area = <0x01>;
			tbat_level_def = <0x00 0x00 0x0a 0x0f 0x19 0x19 0x19 0x19 0x19 0x19 0x19 0x19 0x19 0x19 0x19 0x2c 0x2e>;
			tbat_curlmt = <0xffffffff 0xffffffff 0x00 0x00 0x00 0x00 0x00 0x00 0x00 0x00 0x00 0x00 0x00 0x00 0x00 0x708 0xffffffff>;
			tbat_recovery_area = <0x01>;
			tpcb_level_def = <0x00 0x00 0x00 0x00 0x19 0x1e 0x22 0x25 0x26 0x27 0x28 0x29 0x2a 0x2b 0x2c 0x2d 0x5a>;
			tpcb_curlmt = <0xffffffff 0xffffffff 0x00 0x00 0x00 0x00 0x00 0x320 0x514 0x6a4 0x76c 0x7d0 0x834 0x898 0x9c4 0xbb8 0xffffffff>;
			tpcb_recovery_area = <0x01>;
			tpa_level_def = <0x00 0x00 0x00 0x0f 0x19 0x21 0x22 0x23 0x24 0x25 0x26 0x28 0x29 0x2a 0x2b 0x2c 0x50>;
			tpa_curlmt = <0xffffffff 0xffffffff 0x00 0x00 0x00 0x2bc 0x384 0x4b0 0x5dc 0x640 0x708 0x7d0 0x898 0x8fc 0x960 0xa28 0xffffffff>;
			tpa_recovery_area = <0x01>;
			supprot_multi_level_charging;
			tbat_level_def_0 = <0x00 0x00 0x0a 0x0f 0x19 0x1e 0x21 0x24 0x25 0x26 0x27 0x28 0x29 0x2a 0x2b 0x2c 0x2e>;
			tbat_curlmt_0 = <0xffffffff 0xffffffff 0x00 0x00 0x00 0x00 0x00 0x320 0x514 0x6a4 0x76c 0x7d0 0x834 0x898 0x9c4 0xbb8 0xffffffff>;
			tbat_level_def_1 = <0x00 0x00 0x0a 0x0f 0x19 0x21 0x22 0x23 0x24 0x25 0x26 0x28 0x29 0x2a 0x2b 0x2c 0x2e>;
			tbat_curlmt_1 = <0xffffffff 0xffffffff 0x00 0x00 0x00 0x2bc 0x384 0x4b0 0x5dc 0x6a4 0x76c 0x7d0 0x898 0x8fc 0x9c4 0xaf0 0xffffffff>;
			tbat_level_def_2 = <0x00 0x00 0x0a 0x0f 0x19 0x1d 0x1e 0x1f 0x20 0x22 0x24 0x26 0x28 0x29 0x2b 0x2d 0x2e>;
			tbat_curlmt_2 = <0xffffffff 0xffffffff 0x00 0x00 0x00 0x00 0x190 0x1f4 0x960 0x9c4 0x9c4 0x9c4 0xa28 0xa28 0xa28 0xa28 0xffffffff>;
			tpcb_level_def_0 = <0x00 0x00 0x00 0x00 0x19 0x1e 0x22 0x25 0x26 0x27 0x28 0x29 0x2a 0x2b 0x2c 0x2d 0x5a>;
			tpcb_curlmt_0 = <0xffffffff 0xffffffff 0x00 0x00 0x00 0x00 0x00 0x320 0x514 0x6a4 0x76c 0x7d0 0x834 0x898 0x9c4 0xbb8 0xffffffff>;
			tpcb_level_def_1 = <0x00 0x00 0x00 0x0f 0x19 0x21 0x22 0x23 0x24 0x25 0x26 0x28 0x29 0x2a 0x2b 0x2c 0x5a>;
			tpcb_curlmt_1 = <0xffffffff 0xffffffff 0x00 0x00 0x00 0x2bc 0x384 0x4b0 0x5dc 0x640 0x708 0x7d0 0x898 0x8fc 0x960 0xa28 0xffffffff>;
			tpcb_level_def_2 = <0x00 0x00 0x00 0x00 0x19 0x1d 0x1e 0x1f 0x20 0x22 0x24 0x26 0x28 0x29 0x2b 0x2d 0x5a>;
			tpcb_curlmt_2 = <0xffffffff 0xffffffff 0x00 0x00 0x00 0x00 0x190 0x1f4 0x960 0x9c4 0x9c4 0x9c4 0xa28 0xa28 0xa28 0xa28 0xffffffff>;
			tpa_level_def_0 = <0x00 0x00 0x00 0x16 0x19 0x19 0x19 0x19 0x26 0x27 0x29 0x2a 0x2b 0x2c 0x2d 0x2e 0x5a>;
			tpa_curlmt_0 = <0xffffffff 0xffffffff 0x00 0x00 0x00 0x00 0x00 0x00 0x1f4 0x320 0x44c 0x578 0x640 0x7d0 0x8fc 0xaf0 0xffffffff>;
			tpa_level_def_1 = <0x00 0x00 0x00 0x16 0x19 0x19 0x22 0x23 0x24 0x25 0x26 0x27 0x28 0x29 0x2a 0x2c 0x5a>;
			tpa_curlmt_1 = <0xffffffff 0xffffffff 0x00 0x00 0x00 0x00 0x384 0x44c 0x514 0x5dc 0x6a4 0x76c 0x834 0x8fc 0x9c4 0xaf0 0xffffffff>;
			tpa_level_def_2 = <0x00 0x00 0x00 0x16 0x19 0x19 0x19 0x1d 0x1e 0x20 0x21 0x23 0x25 0x27 0x29 0x2b 0x5a>;
			tpa_curlmt_2 = <0xffffffff 0xffffffff 0x00 0x00 0x00 0x00 0x00 0x640 0x6a4 0x76c 0x834 0x898 0x8fc 0x960 0x9c4 0xaf0 0xffffffff>;
			sys_power_level_def = <0x00 0x00 0x190 0x320 0x4b0 0x578 0x640 0x7d0 0x960 0xaf0 0xc80 0xe10 0xfa0 0x1130 0x12c0 0x1450 0xc350>;
			sys_power_curlmt = <0xffffffff 0xffffffff 0x00 0xc80 0xbb8 0xa28 0x834 0x578 0x3e8 0x3e8 0x3e8 0x3e8 0x3e8 0x384 0x384 0x384 0xffffffff>;
			sys_power_recovery_area = <0x190>;
			ifod_threshold = <0xc8>;
			rsw_min = <0x14>;
			ircmp_rbat = <0x0a>;
			ircmp_vclamp = <0x0a>;
			support_ta = "tfcp_adapter\0pd_adapter";
			allow_not_check_ta_status;
			vbat_threshold = <0x10fe>;
			rechg_tbat_high = <0x2c>;
			rechg_tbat_low = <0x0c>;
			project_pwr_ratio = <0x46>;
			project_power = <0x2d>;
			min_ita_gap = <0x0a>;
			ita_stable_cnt = <0x14>;
			vol_diff_gap = <0x32>;
			cable_capability_level = <0x00 0x1388 0x1770 0x2328>;
			vol_diff_level = <0x3e8 0x3e8 0x4b0 0x5dc>;
			pe50_vta_init = <0x14b4>;
			pe50_ita_init = <0xbb8>;
			run_cp_cur = <0x00 0x9c4 0x109a 0x2328>;
			run_cp_recovery_gap = <0x00 0x1f4 0x2ee 0x3e8>;
			run_wls_cp_cur = <0x00 0xbb8 0x1770 0x2710>;
			run_wls_cp_recovery_gap = <0x00 0xc8 0x190 0x258>;
			support_spec = <0x00 0x00 0x00 0x01 0x00>;
			vta_cap_min = <0x1a90 0x1a90 0x1a90 0x1a90 0xfa0>;
			vta_cap_max = <0x7724 0x5014 0x5014 0x2904 0x1b58>;
			ita_cap_min = <0x3e8 0x3e8 0x3e8 0x3e8 0x3e8>;
			vbus_max_ovp = <0x80e8 0x5014 0x5014 0x2af8 0x1b58>;
			pe5_ffc_gap = <0x14 0x14 0x14 0x14 0x14 0x14>;
			step_ffc_level = <0x0c>;
			step_ffc_level_0 = <0x00 0x0a 0x11b2 0x11b2 0x11b2 0x11b2 0x11b2 0x11b2 0x9e2 0x9e2 0x9e2 0x9e2 0x9e2 0x9e2 0x4b0 0xffffffff 0xffffffff 0x00>;
			step_ffc_level_1 = <0x0a 0x0f 0x11b2 0x11b2 0x11b2 0x11b2 0x11b2 0x11b2 0x13c4 0x13c4 0x13c4 0x13c4 0x13c4 0x13c4 0x4b0 0xffffffff 0xffffffff 0x00>;
			step_ffc_level_2 = <0x0f 0x23 0x1068 0x1194 0x11b2 0x11d0 0x11d0 0x11d0 0x1f40 0x19b2 0x13c4 0xdd6 0xdd6 0xdd6 0x5aa 0x00 0xc8 0x01 0x9c4>;
			step_ffc_level_3 = <0x0f 0x23 0x1068 0x1180 0x119e 0x11bc 0x11bc 0x11bc 0x1f40 0x19b2 0x13c4 0xdd6 0xdd6 0xdd6 0x5aa 0xc8 0x12c 0x14 0x9c4>;
			step_ffc_level_4 = <0x0f 0x23 0x1068 0x116c 0x118a 0x11a8 0x11a8 0x11a8 0x1f40 0x19b2 0x13c4 0xdd6 0xdd6 0xdd6 0x5aa 0x12c 0x1f4 0x28 0x9c4>;
			step_ffc_level_5 = <0x0f 0x23 0x1068 0x1158 0x1176 0x1194 0x1194 0x1194 0x1f40 0x19b2 0x13c4 0xdd6 0xdd6 0xdd6 0x5aa 0x1f4 0x3e8 0x3c 0x9c4>;
			step_ffc_level_6 = <0x0f 0x23 0x1068 0x1126 0x1144 0x1162 0x1162 0x1162 0x1f40 0x19b2 0x13c4 0xdd6 0xdd6 0xdd6 0x5aa 0x3e8 0xffffffff 0x6e 0x9c4>;
			step_ffc_level_7 = <0x23 0x2d 0x1068 0x1194 0x11b2 0x11d0 0x11d0 0x11d0 0x1f40 0x19b2 0x13c4 0xdd6 0xdd6 0xdd6 0x84d 0x00 0xc8 0x14 0x9c4>;
			step_ffc_level_8 = <0x23 0x2d 0x1068 0x1180 0x119e 0x11bc 0x11bc 0x11bc 0x1f40 0x19b2 0x13c4 0xdd6 0xdd6 0xdd6 0x84d 0xc8 0x12c 0x28 0x9c4>;
			step_ffc_level_9 = <0x23 0x2d 0x1068 0x116c 0x118a 0x11a8 0x11a8 0x11a8 0x1f40 0x19b2 0x13c4 0xdd6 0xdd6 0xdd6 0x84d 0x12c 0x1f4 0x3c 0x9c4>;
			step_ffc_level_10 = <0x23 0x2d 0x1068 0x1158 0x1176 0x1194 0x1194 0x1194 0x1f40 0x19b2 0x13c4 0xdd6 0xdd6 0xdd6 0x84d 0x1f4 0x3e8 0x50 0x9c4>;
			step_ffc_level_11 = <0x23 0x2d 0x1068 0x1126 0x1144 0x1162 0x1162 0x1162 0x1f40 0x19b2 0x13c4 0xdd6 0xdd6 0xdd6 0x84d 0x3e8 0xffffffff 0x82 0x9c4>;
		};
	};

	fragment@24 {
		target = <0xffffffff>;

		__overlay__ {
			#address-cells = <0x01>;
			#size-cells = <0x00>;
			clock-frequency = <0x61a80>;
			mediatek,use-open-drain;

			upm7610@60 {
				compatible = "unisemipower,upm7610";
				reg = <0x60>;
				status = "okay";
				up-tcpc,name = "type_c_port0";
				up-tcpc,role-def = <0x05>;
				up-tcpc,rp-level = <0x00>;
				up-tcpc,vconn-supply = <0x01>;
				rt-tcpc,notifier_supply_num = <0x03>;
				upm7610pd,intr-gpio = <0xffffffff 0x45 0x00>;
				upm7610pd,intr-gpio-num = <0x45>;

				pd-data {
					pd,vid = <0x362f>;
					pd,pid = <0x7610>;
					pd,source-cap-ext = [cf 29 11 17 00 00 00 00 00 00 00 00 00 00 00 00 00 00 00 00 00 00 01 02 00];
					pd,sink-cap-ext = <0xcf291117 0x00 0x100 0x00 0x10b010a 0xa000000>;
					pd,mfrs = "UnisemipowerTCPC";
					pd,charging_policy = <0x31>;
					pd,source-pdo-size = <0x02>;
					pd,source-pdo-data = <0x26019032 0x260190c8>;
					pd,sink-pdo-size = <0x01>;
					pd,sink-pdo-data = <0x190c8>;
					pd,id-vdo-size = <0x06>;
					pd,id-vdo-data = <0xd140362f 0x00 0x76100000 0x61000000 0x00 0x41000000>;
					bat,nr = <0x01>;
					pd,country_nr = <0x00>;

					bat-info0 {
						bat,vid = <0x362f>;
						bat,pid = <0x7610>;
						bat,mfrs = "bat1";
						bat,design_cap = <0xbb8>;
					};
				};

				dpm-caps {
					local-dr-power;
					local-dr-data;
					local-usb-comm;
					local-no-suspend;
					pr-check = <0x00>;
					dr-check = <0x00>;
				};

				displayport {
					1st_connection = "dfp_d";
					2nd_connection = "dfp_d";
					typec,receptacle;

					ufp_d {
					};

					dfp_d {
						pin_assignment,mode_c;
						pin_assignment,mode_d;
						pin_assignment,mode_e;
					};
				};
			};
		};
	};

	fragment@25 {
		target = <0xffffffff>;

		__overlay__ {
			#address-cells = <0x01>;
			#size-cells = <0x00>;

			sc-swchg@6b {
				compatible = "southchip,sc8950\0mediatek,sgm41516d";
				reg = <0x6b>;
				sc8950,intr_gpio = <0xffffffff 0x04 0x00>;
				status = "okay";
				phys = <0xffffffff 0x03>;
				phy-names = "usb2-phy";
				usb = <0xffffffff>;
				chg_name = "primary_chg";
				chg_alias_name = "sc8950_chg";
				alias_name = "sgm41516d_chg";
				phandle = <0x49>;

				usb-otg-vbus {
					regulator-compatible = "usb-otg-vbus";
					regulator-name = "usb-otg-vbus";
					regulator-min-microvolt = <0x4a0150>;
					regulator-max-microvolt = <0x50df20>;
					regulator-min-microamp = <0x7a120>;
					regulator-max-microamp = <0x124f80>;
					phandle = <0x4a>;
				};
			};
		};
	};

	fragment@26 {
		target = <0xffffffff>;

		__overlay__ {

			pca_tfcp_ta {
				compatible = "tc,pca_tfcp_ta";
				status = "okay";
				adapter_name = "tfcp_adapter";
				vta_step = <0x28>;
				ita_step = <0x1e>;
				ita_gap_per_vstep = <0x14>;
				ita_gap_cv_mode = <0x64>;
				pwr_lmt;
				support_meas_cap;
				support_status;
			};

			tc_pd_adapter {
				compatible = "tc,pd_adapter";
				boot_mode = <0xffffffff>;
				adapter_name = "pd_adapter";
				force_cv;
				phys = <0xffffffff 0x03>;
				phy-names = "usb2-phy";
				status = "okay";
				phandle = <0x4b>;
			};
		};
	};

	fragment@27 {
		target = <0xffffffff>;

		__overlay__ {
			clock-frequency = <0x186a0>;

			tfcp_ta@1b {
				compatible = "tc,tfcp_ta";
				pinctrl-names = "tfcp_i2c_sclk_mode\0tfcp_i2c_sda_mode";
				pinctrl-0 = <0x21>;
				pinctrl-1 = <0x22>;
				reg = <0x1b>;
				status = "okay";
			};
		};
	};

	fragment@28 {
		target = <0xffffffff>;

		__overlay__ {

			i2c_sclk_mode {
				phandle = <0x21>;

				pins_cmd_dat {
					pinmux = <0x9001>;
					bias-pull-up = <0xcd>;
					mediatek,drive-strength-adv = <0x00>;
					drive-strength = <0x03>;
				};
			};

			i2c_sda_mode {
				phandle = <0x22>;

				pins_cmd_dat {
					pinmux = <0x9101>;
					bias-pull-up = <0xcd>;
					mediatek,drive-strength-adv = <0x00>;
					drive-strength = <0x03>;
				};
			};
		};
	};

	fragment@29 {
		target = <0xffffffff>;

		__overlay__ {
			status = "disabled";
		};
	};

	fragment@30 {
		target = <0xffffffff>;

		__overlay__ {
			compatible = "transsion,extcon-usb";
			charger = <0x20>;
			tcpc = "type_c_port0";
			mediatek,bypss-typec-sink = <0x01>;
			mediatek,u2;

			port {

				endpoint@0 {
					remote-endpoint = <0xffffffff>;
					phandle = <0x4c>;
				};
			};
		};
	};

	fragment@31 {
		target = <0xffffffff>;

		__overlay__ {
			mediatek,eye-vrt = <0x07>;
			mediatek,eye-term = <0x07>;
			mediatek,rev6 = <0x02>;
			mediatek,discth = <0x0c>;
			mediatek,eye-vrt-host = <0x07>;
			mediatek,eye-term-host = <0x05>;
			mediatek,rev6-host = <0x03>;
		};
	};

	fragment@32 {
		target = <0xffffffff>;

		__overlay__ {

			tran_otg {
				compatible = "tran,otg_fun";
				status = "okay";
				pd_reverse_chg_support;
				otg_revercharge_limit_temp = <0x2d>;
				tc_otg_boost_curr_max = <0x1e8480>;
				tc_otg_boost_curr_min = <0x7a120>;
				otg_reverse_chg_curr_lmt = <0xf4240>;
				otg_reverse_chg_limit_temp_step1 = <0x2a>;
				otg_reverse_chg_recovery_area = <0x03>;
				phandle = <0x4d>;
			};

			tc_trancare {
				compatible = "tc,trancare";
				status = "okay";
				phandle = <0x4e>;
			};

			tc_audio {
				compatible = "tc_audio";
				status = "okay";
				water_detect = <0x23>;
				phandle = <0x4f>;
			};

			water_detect {
				status = "okay";
				compatible = "transsion, water_detect";
				bootmode = <0xffffffff>;
				polling_interval = <0x05>;
				scheme = <0x03>;
				phandle = <0x23>;
			};

			port_corrosion {
				status = "okay";
				compatible = "transsion,port_corrosion";
				phandle = <0x50>;
			};

			phy_insert_det {
				status = "okay";
				compatible = "transsion,phy_det";
				phy,intr-gpio = <0xffffffff 0x14 0x00>;
				phandle = <0x51>;
			};

			tc_pmic {
				compatible = "tc_pmic";
				status = "okay";
				io-channels = <0xffffffff 0x02>;
				io-channel-names = "pmic_vbus";
				phandle = <0x52>;
			};

			tc_chgtype {
				compatible = "tc_chgtype";
				phys = <0xffffffff 0x03>;
				phy-names = "usb2-phy";
				usb = <0xffffffff>;
				status = "okay";
				phandle = <0x20>;
			};

			tc_gauge {
				compatible = "tc_gauge";
				gauge = <0xffffffff>;
				status = "okay";
				phandle = <0x53>;
			};

			tc_misc {
				compatible = "tc,misc_intf";
				bootmode = <0xffffffff>;
				det_ibus_by_swchg;
				io-channels = <0xffffffff 0x05>;
				io-channel-names = "tusb";
				tusb_div_res = <0x5f370>;
				tusb_div_vol = <0x708>;
				min_tusb_temp = <0xffffff38>;
				max_tusb_temp = <0x258>;
				phandle = <0x54>;
			};

			tc_lcd {
				compatible = "tc,lcd";
				phandle = <0x55>;
			};

			tc_pe2 {
				compatible = "transsion,pe20_charger";
				status = "okay";
				ta_ichg_level_threshold = <0xf4240>;
				ta_stop_battery_soc = <0x5a>;
				vbat_threshold = <0x426030>;
				chr_volt = <0x4c4b40 0x895440>;
				chr_volt_mivr = <0x4630c0 0x7a1200>;
				chr_volt_input_cur = <0x1e8480 0x249f00>;
				chr_volt_chg_cur = <0x1e8480 0x36ee80>;
				phandle = <0x56>;
			};

			tc_30 {
				compatible = "transsion,tc30_charger";
				status = "okay";
				ta_ichg_level_threshold = <0xf4240>;
				ta_stop_battery_soc = <0x5a>;
				vbat_threshold = <0x426030>;
				recover_7v5_gap = <0x7a120>;
				chr_volt = <0x4c4b40 0x7270e0 0x4c4b40 0x7270e0>;
				chr_volt_mivr = <0x4630c0 0x663be0 0x4630c0 0x663be0>;
				chr_volt_input_cur = <0x1e8480 0x249f00 0x1e8480 0x249f00>;
				chr_volt_chg_cur = <0x1e8480 0x36ee80 0x1e8480 0x36ee80>;
				phandle = <0x57>;
			};

			tc_hvdcp20 {
				compatible = "transsion,hvdcp20_charger";
				status = "okay";
				ta_ichg_level_threshold = <0xf4240>;
				ta_stop_battery_soc = <0x5a>;
				vbat_threshold = <0x426030>;
				recover_9v_gap = <0x7a120>;
				chr_volt = <0x4c4b40 0x895440 0x4c4b40 0x895440>;
				chr_volt_mivr = <0x4630c0 0x7a1200 0x4630c0 0x7a1200>;
				chr_volt_input_cur = <0x1e8480 0x249f00 0x1e8480 0x249f00>;
				chr_volt_chg_cur = <0x1e8480 0x36ee80 0x1e8480 0x36ee80>;
				phandle = <0x58>;
			};

			tc_pd {
				compatible = "transsion,pd_charger";
				status = "okay";
				min_charger_voltage = <0x4630c0>;
				charger_current_limit = <0x36ee80>;
				pd_vbus_upper_bound = <0x989680>;
				pd_vbus_low_bound = <0x4c4b40>;
				ta_ichg_level_threshold = <0xf4240>;
				pd_stop_battery_soc = <0x5a>;
				vbat_threshold = <0x426030>;
				phandle = <0x59>;
			};

			tc_auto_test {
				compatible = "tc,auto_test";
				status = "okay";
				phandle = <0x5a>;
			};

			pid_chg {
				compatible = "tc,pid_chg_algo";
				pid_array = <0x3e8 0x64 0x2710>;
				polling_interval = <0x2710>;
				ambient_temp = <0xfa 0xfa 0xfa 0xfa 0x15e>;
				target_temp_array = <0xfa0 0xfa0 0xfa0 0xfa0 0x10cc>;
				power_level = <0x320 0x640 0x960 0xc80 0xfa0>;
				power_delta_temp = <0x00 0x64 0xc8 0x12c 0x12c>;
				power_update_time = <0x12c>;
				power_meas_current = <0x61a80>;
				target_temp_gap = <0x32>;
				steady_cycle = <0x02>;
				max_steady_target_delta_temp = <0x32>;
				max_steady_delta_temp = <0x1e>;
				normal_steady_delta_temp = <0x14>;
				max_unsteady_cnt = <0x02>;
				max_target_temp = <0x1130>;
				ibus_measure_power_update_time = <0x3c>;
				delta_current_max = <0x7a120>;
				phandle = <0x5b>;
			};

			ambient_detect {
				compatible = "tc,ambient_detect";
				polling_interval = <0x1a4>;
				ambient_max_power = <0x8ca>;
				ambient_max_temp = <0x258>;
				ambient_min_temp = <0xffffff38>;
				min_detection_duration = <0x12c>;
				ambient_low_power_update_time = <0x4b0>;
				ambient_max_update_time = <0x2a30>;
				ambient_max_temp_rate = <0x384>;
				ambient_max_diff_pcb_temp = <0x32>;
				power_level = <0x190 0x320 0x4b0 0x640 0x7d0>;
				power_delta_temp = <0x00 0x0a 0x14 0x1e 0x28>;
				phandle = <0x5c>;
			};

			temp_forecast {
				compatible = "tc,temp_forecast";
				orgin_rate = <0x55>;
				max_temp_diff = <0x96>;
				max_comp_temp = <0x1e>;
				pa_temp_gap = <0x1f4>;
				per_rate_time = <0x05>;
				phandle = <0x5d>;
			};

			tc_tcpc {
				compatible = "tc_tcpc";
				status = "okay";
				phandle = <0x5e>;
			};

			tc_adapter_control {
				compatible = "transsion, adapter_control";
				polling_interval = <0x1e>;
				status = "okay";
				phandle = <0x5f>;
			};
		};
	};

	fragment@33 {
		target = <0xffffffff>;

		__overlay__ {
			compatible = "tc,charger";
			enable_sw_jeita;
			enable_hv_charging;
			enable_sw_safety_timer;
			support_allround_bypass;
			support_real_soc_decimal;
			ftm_cp_num = <0x01>;
			enable_dynamic_mivr;
			enable_ir_comp;
			support_long_life_recharger;
			long_life_rechg_time = <0xb4>;
			support_hardware_ir_comp;
			r_comp = <0x14>;
			v_comp_max = <0x0f>;
			log_level = <0x03>;
			aging_start_uisoc = <0x46>;
			aging_stop_uisoc = <0x4b>;
			kom_start_uisoc = <0x28>;
			kom_stop_uisoc = <0x46>;
			batt_over_heat_temp = <0x3c>;
			batt_over_cold_temp = <0xffffffec>;
			bat_health_cycle_base = <0x00>;
			bat_health_dec_times = <0x5a>;
			polling_interval = <0x0a>;
			min_charger_voltage = <0x432380>;
			min_charger_current = <0xf4240>;
			support_alg = "pe5\0tc30\0pd\0hvdcp20\0pe20";
			tbat_temp = <0xffffff9c 0x0f 0x23 0x26 0x28 0x2a 0x2b 0x2c 0x37 0x3c 0x41 0x46>;
			tbat_ichg = <0x00 0x00 0x7a120 0xc3500 0xf4240 0x16e360 0x19f0a0 0x1e8480 0x249f00 0x249f00 0x249f00 0x249f00>;
			tbat_temp_gap = <0x01>;
			tpcb_temp = <0xffffff9c 0x0f 0x1e 0x23 0x25 0x27 0x29 0x2d 0x37 0x3c 0x41 0x46>;
			tpcb_ichg = <0x00 0x00 0x00 0x30d40 0x493e0 0x7a120 0xaae60 0xdbba0 0x13d620 0x16e360 0x1e8480 0x1e8480>;
			tpcb_temp_gap = <0x01>;
			tpa_temp = <0xffffff9c 0x0f 0x1e 0x23 0x25 0x27 0x29 0x2d 0x37 0x3c 0x41 0x46>;
			tpa_ichg = <0x00 0x00 0x00 0x30d40 0x493e0 0x7a120 0xaae60 0xdbba0 0x13d620 0x16e360 0x1e8480 0x1e8480>;
			tpa_temp_gap = <0x01>;
			batt_ht_temp = <0x35 0x37 0x3a>;
			batt_ht_rec_temp = <0x00 0x36 0x36>;
			batt_ht_code = <0x00 0x800 0x400>;
			batt_ht_vote_hiz = <0x00 0x00 0x00>;
			batt_ht_vote_discharge = <0x00 0x01 0x01>;
			batt_ht_vote_icon = <0x00 0x01 0x01>;
			batt_lt_temp = <0x00 0xffffffed 0xffffffed>;
			batt_lt_rec_temp = <0x00 0xffffffef 0xffffffef>;
			batt_lt_code = <0x00 0x00 0x1080>;
			batt_lt_vote_hiz = <0x00 0x00 0x00>;
			batt_lt_vote_discharge = <0x00 0x01 0x01>;
			batt_lt_vote_icon = <0x00 0x01 0x01>;
			kpoc_batt_ht_temp = <0x35 0x37 0x3a>;
			kpoc_batt_ht_rec_temp = <0x00 0x36 0x36>;
			kpoc_batt_ht_code = <0x00 0x800 0x400>;
			kpoc_batt_ht_vote_hiz = <0x00 0x00 0x00>;
			kpoc_batt_ht_vote_discharge = <0x00 0x01 0x01>;
			kpoc_batt_ht_vote_icon = <0x00 0x01 0x01>;
			kpoc_batt_lt_temp = <0x00 0xffffffed 0xffffffed>;
			kpoc_batt_lt_rec_temp = <0x00 0xffffffef 0xffffffef>;
			kpoc_batt_lt_code = <0x00 0x00 0x1080>;
			kpoc_batt_lt_vote_hiz = <0x00 0x00 0x00>;
			kpoc_batt_lt_vote_discharge = <0x00 0x01 0x01>;
			kpoc_batt_lt_vote_icon = <0x00 0x01 0x01>;
			batt_ht_temp_dis_chg = <0x3a 0x3a 0x3a>;
			batt_ht_code_dis_chg = <0x400 0x400 0x400>;
			batt_lt_temp_dis_chg = <0xffffffed 0xffffffed 0xffffffed>;
			batt_lt_code_dis_chg = <0x80 0x80 0x80>;
			dynamic_mivr_vol = <0x432380 0x432380 0x432380 0x4630c0>;
			charger_voltage_ovp = <0x632ea0 0xa037a0 0xa7d8c0 0xa7d8c0>;
			max_charging_time = <0x11940>;
			sdp_charger_current = <0x7a120>;
			sdp_input_current = <0x7a120>;
			cdp_charger_current = <0xf4240>;
			cdp_input_current = <0xf4240>;
			dcp_charger_current = <0x1e8480>;
			dcp_input_current = <0x1e8480>;
			nonstd_charger_current = <0x124f80>;
			nonstd_input_current = <0x124f80>;
			max_input_current_limit = <0x2dc6c0>;
			max_charging_current_limit = <0x36ee80>;
			swchg_hw_eoc_max = "\0\f5";
			vbat_gap = <0x9c40 0x9c40 0x9c40 0x9c40 0x9c40 0x9c40>;
			single_batt_level = <0x05>;
			single_batt_level_0 = <0xffffffed 0x00 0xffffffff 0x451f50 0x451f50 0x451f50 0x451f50 0x451f50 0x451f50 0x7b890 0x7b890 0x7b890 0x7b890 0x7b890 0x7b890 0x41eb0 0x00 0xffffffff 0x00>;
			single_batt_level_1 = <0x00 0x0a 0xffffffff 0x451f50 0x451f50 0x451f50 0x451f50 0x451f50 0x451f50 0x28d138 0x28d138 0x28d138 0x28d138 0x28d138 0x28d138 0x41eb0 0x00 0xffffffff 0x00>;
			single_batt_level_2 = <0x0a 0x0f 0xffffffff 0x451f50 0x451f50 0x451f50 0x451f50 0x451f50 0x451f50 0x36ee80 0x36ee80 0x36ee80 0x36ee80 0x36ee80 0x36ee80 0x41eb0 0x00 0xffffffff 0x00>;
			single_batt_level_3 = <0x0f 0x2d 0xffffffff 0x451f50 0x451f50 0x451f50 0x451f50 0x451f50 0x451f50 0x36ee80 0x36ee80 0x36ee80 0x36ee80 0x36ee80 0x36ee80 0x41eb0 0x00 0xffffffff 0x00>;
			single_batt_level_4 = <0x2d 0x3c 0xffffffff 0x401640 0x401640 0x401640 0x401640 0x401640 0x401640 0x28d138 0x28d138 0x28d138 0x28d138 0x28d138 0x28d138 0x41eb0 0x00 0xffffffff 0x00>;
		};
	};

	fragment@34 {
		target = <0xffffffff>;

		__overlay__ {
			tran_dev_name = "mtk_gauge";
			charger = <0x20>;
		};
	};

	fragment@35 {
		target = <0xffffffff>;

		__overlay__ {
			status = "disabled";
		};
	};

	fragment@36 {
		target = <0xffffffff>;

		__overlay__ {
			charger = <0x20>;
		};
	};

	fragment@37 {
		target = <0xffffffff>;

		__overlay__ {
			compatible = "mediatek,lk_charger";
			enable-anime;
			enable-pe_plus;
			enable-pd20_reset;
			power-path-support;
			max-charger-voltage = <0x632ea0>;
			fast-charge-voltage = <0x231860>;
			low-bat-temp-boot-vbat = <0x36ee80>;
			usb-charger-current = <0x7a120>;
			ac-charger-current = <0x1e8480>;
			ac-charger-input-current = <0x1e8480>;
			non-std-ac-charger-current = <0x124f80>;
			charging-host-charger-current = <0x16e360>;
			ta-ac-charger-current = <0x2dc6c0>;
			pd-charger-current = <0x7a120>;
			cur-threshold = <0x7a120>;
			temp-t0-current = <0xf4240>;
			temp-neg-t0-current = <0x7a120>;
			temp-t4-threshold = <0x38>;
			temp-t3-threshold = <0x2d>;
			temp-t2-threshold = <0x0f>;
			temp-t1-threshold = <0x00>;
			temp-t0-threshold = <0xfffffff6>;
			temp-neg-t0-threshold = <0xffffffec>;
		};
	};

	fragment@38 {
		target = <0xffffffff>;

		__overlay__ {

			speaker_amp@5c {
				compatible = "richtek,rt5512";
				#sound-dai-cells = <0x00>;
				reg = <0x5c>;
				status = "okay";
				sound-name-prefix = "Left";
				phandle = <0x24>;
			};
		};
	};

	fragment@39 {
		target = <0xffffffff>;

		__overlay__ {
			mediatek,spk-i2s = <0x03 0x00>;

			mediatek,speaker-codec {
				sound-dai = <0x24>;
			};
		};
	};

	fragment@40 {
		target = <0xffffffff>;

		__overlay__ {
			pd_vbus_upper_bound = <0x895440>;
		};
	};

	fragment@41 {
		target = <0xffffffff>;

		__overlay__ {

			fingerprint {
				compatible = "tran_fp_legacy";
				interrupt-parent = <0xffffffff>;
				interrupts = <0x0d 0x01 0x0d 0x00>;
				debounce = <0x0d 0x00>;
				pinctrl-names = "tran_fp_default\0tran_fp_pin_irq\0tran_fp_irq_pull_down\0tran_fp_reset_high\0tran_fp_reset_low\0tran_fp_spi_default";
				pinctrl-0 = <0x25>;
				pinctrl-1 = <0x26>;
				pinctrl-2 = <0x27>;
				pinctrl-3 = <0x28>;
				pinctrl-4 = <0x29>;
				pinctrl-5 = <0x2a>;
				status = "okay";
				phandle = <0x60>;
			};
		};
	};

	fragment@42 {
		target = <0xffffffff>;

		__overlay__ {

			fingerprint@0 {
				compatible = "tran_fp_legacy";
				reg = <0x00>;
				spi-max-frequency = <0x19bfcc0>;
				interrupt-parent = <0xffffffff>;
				interrupts = <0x0d 0x01 0x0d 0x00>;
				debounce = <0x0d 0x00>;
				irq-gpio = <0x0d>;
				irq-gpio-std = <0xffffffff 0x0d 0x00>;
				reset-gpio = <0x77>;
				reset-gpio-std = <0xffffffff 0x77 0x00>;
				tran,gpio_pwr = <0x3b>;
				tran,gpio_pwr-std = <0xffffffff 0x3b 0x00>;
				fod_location_xy = "540,2210";
				tran_fp_sched;
				goodix;
				pinctrl-names = "tran_fp_default\0tran_fp_pin_irq\0tran_fp_irq_pull_down\0tran_fp_reset_high\0tran_fp_reset_low\0tran_fp_spi_default";
				pinctrl-0 = <0x25>;
				pinctrl-1 = <0x26>;
				pinctrl-2 = <0x27>;
				pinctrl-3 = <0x28>;
				pinctrl-4 = <0x29>;
				pinctrl-5 = <0x2a>;
				status = "okay";
			};
		};
	};

	fragment@43 {
		target = <0xffffffff>;

		__overlay__ {

			fingerprint_default {
				phandle = <0x25>;
			};

			gpio13_eint {
				phandle = <0x26>;

				pins_cmd_dat {
					pinmux = <0xd00>;
					slew-rate = <0x00>;
					bias-disable;
				};
			};

			gpio13_eint_pull_down {
				phandle = <0x27>;

				pins_cmd_dat {
					pinmux = <0xd00>;
					slew-rate = <0x00>;
					bias-pull-down = <0x00>;
					output-low;
				};
			};

			rst_out_one {
				phandle = <0x28>;

				pins_cmd_dat {
					pinmux = <0x7700>;
					slew-rate = <0x01>;
					bias-disable;
					output-high;
				};
			};

			rst_out_zero {
				phandle = <0x29>;

				pins_cmd_dat {
					pinmux = <0x7700>;
					slew-rate = <0x01>;
					bias-disable;
					output-low;
				};
			};

			spimode_default {
				phandle = <0x2a>;

				pins_cmd_dat {
					pinmux = <0x2c01 0x2d01 0x2b01 0x2a01>;
					drive-strength = <0x07>;
				};
			};
		};
	};

	fragment@44 {
		target = <0xffffffff>;

		__overlay__ {
			status = "disabled";
		};
	};

	fragment@45 {
		target = <0xffffffff>;

		__overlay__ {
			sensor-get-screen-power-state = <0x00>;
			tran-charger-poll = <0x01>;
			tran-cloud-tracking-sensor-data = <0x00>;
			tran-sensor-debug = <0x00>;
			nv_restore_time = <0x03>;
			sensor_type = <0x01 0x02 0x04 0x05 0x00 0x00>;
		};
	};

	fragment@46 {
		target = <0xffffffff>;

		__overlay__ {
			pwm_ch = <0x02>;
			status = "okay";
			ir-power = "vbat";
		};
	};

	fragment@47 {
		target = <0xffffffff>;

		__overlay__ {
			tran,rpmb_control = <0x01>;
		};
	};

	fragment@48 {
		target = <0xffffffff>;

		__overlay__ {

			adc_channel@ {
				compatible = "mediatek,adc_channel";
				mediatek,adc_fdd_rf_params_dynamic_custom_ch = <0x02>;
				status = "okay";
			};
		};
	};

	fragment@49 {
		target = <0xffffffff>;

		__overlay__ {
			GPIO_SIM1_HOT_PLUG = <0xffffffff 0x17 0x00>;
			GPIO_SIM1_SCLK = <0xffffffff 0x4d 0x00>;
			GPIO_SIM1_SRST = <0xffffffff 0x4e 0x00>;
			GPIO_SIM1_SIO = <0xffffffff 0x4f 0x00>;
			GPIO_SIM2_SCLK = <0xffffffff 0x50 0x00>;
			GPIO_SIM2_SRST = <0xffffffff 0x51 0x00>;
			GPIO_SIM2_SIO = <0xffffffff 0x52 0x00>;
		};
	};

	fragment@50 {
		target = <0xffffffff>;

		__overlay__ {
			gpio_init_default = <0x00 0x00 0x00 0x00 0x01 0x01 0x01 0x01 0x00 0x00 0x00 0x01 0x00 0x00 0x02 0x00 0x00 0x00 0x00 0x00 0x01 0x03 0x00 0x00 0x00 0x01 0x01 0x01 0x04 0x00 0x00 0x00 0x01 0x01 0x01 0x05 0x00 0x00 0x00 0x00 0x00 0x00 0x06 0x00 0x01 0x00 0x01 0x00 0x00 0x07 0x00 0x00 0x00 0x01 0x01 0x01 0x08 0x00 0x01 0x00 0x01 0x00 0x01 0x09 0x00 0x00 0x00 0x01 0x01 0x01 0x0a 0x00 0x01 0x00 0x01 0x00 0x01 0x0b 0x00 0x00 0x00 0x01 0x01 0x01 0x0c 0x00 0x00 0x00 0x01 0x00 0x01 0x0d 0x00 0x00 0x00 0x01 0x00 0x01 0x0e 0x00 0x00 0x00 0x01 0x01 0x00 0x0f 0x00 0x01 0x00 0x01 0x00 0x00 0x10 0x00 0x01 0x00 0x01 0x00 0x00 0x11 0x00 0x01 0x00 0x01 0x00 0x00 0x12 0x00 0x01 0x00 0x01 0x00 0x00 0x13 0x00 0x01 0x00 0x01 0x00 0x00 0x14 0x00 0x00 0x00 0x00 0x00 0x00 0x15 0x00 0x01 0x00 0x01 0x00 0x00 0x16 0x00 0x00 0x00 0x00 0x00 0x00 0x17 0x01 0x00 0x00 0x01 0x01 0x00 0x18 0x00 0x00 0x00 0x01 0x00 0x00 0x19 0x00 0x01 0x00 0x01 0x00 0x01 0x1a 0x00 0x01 0x00 0x01 0x00 0x01 0x1b 0x01 0x01 0x00 0x01 0x00 0x01 0x1c 0x01 0x00 0x00 0x01 0x01 0x01 0x1d 0x01 0x00 0x00 0x00 0x00 0x01 0x1e 0x02 0x00 0x00 0x01 0x00 0x01 0x1f 0x02 0x00 0x00 0x01 0x00 0x01 0x20 0x02 0x00 0x00 0x01 0x00 0x01 0x21 0x02 0x00 0x00 0x01 0x00 0x01 0x22 0x01 0x00 0x00 0x01 0x01 0x00 0x23 0x00 0x00 0x00 0x01 0x00 0x00 0x24 0x01 0x00 0x00 0x01 0x00 0x00 0x25 0x01 0x00 0x00 0x01 0x00 0x00 0x26 0x02 0x00 0x00 0x01 0x00 0x01 0x27 0x02 0x00 0x00 0x01 0x00 0x01 0x28 0x02 0x00 0x00 0x01 0x00 0x01 0x29 0x02 0x00 0x00 0x01 0x00 0x01 0x2a 0x00 0x00 0x00 0x01 0x00 0x00 0x2b 0x00 0x01 0x00 0x01 0x00 0x00 0x2c 0x00 0x00 0x00 0x01 0x00 0x00 0x2d 0x00 0x00 0x00 0x01 0x00 0x00 0x2e 0x01 0x01 0x00 0x00 0x00 0x01 0x2f 0x01 0x01 0x00 0x00 0x00 0x00 0x30 0x01 0x01 0x00 0x00 0x00 0x00 0x31 0x00 0x01 0x00 0x01 0x00 0x01 0x32 0x00 0x01 0x00 0x01 0x00 0x01 0x33 0x00 0x01 0x00 0x01 0x00 0x01 0x34 0x00 0x01 0x00 0x01 0x00 0x01 0x35 0x02 0x00 0x00 0x01 0x00 0x01 0x36 0x00 0x01 0x00 0x01 0x00 0x00 0x37 0x00 0x01 0x00 0x01 0x00 0x00 0x38 0x00 0x01 0x00 0x01 0x00 0x00 0x39 0x00 0x00 0x00 0x01 0x00 0x00 0x3a 0x00 0x01 0x00 0x01 0x00 0x00 0x3b 0x00 0x01 0x00 0x01 0x00 0x00 0x3c 0x00 0x01 0x00 0x01 0x00 0x00 0x3d 0x00 0x01 0x00 0x01 0x00 0x00 0x3e 0x00 0x01 0x00 0x01 0x00 0x00 0x3f 0x00 0x01 0x00 0x01 0x00 0x01 0x40 0x00 0x00 0x00 0x01 0x00 0x01 0x41 0x00 0x01 0x00 0x01 0x00 0x00 0x42 0x01 0x00 0x00 0x01 0x01 0x00 0x43 0x01 0x00 0x00 0x01 0x01 0x00 0x44 0x05 0x00 0x00 0x01 0x00 0x00 0x45 0x00 0x00 0x00 0x01 0x01 0x01 0x4a 0x00 0x01 0x01 0x01 0x00 0x00 0x4b 0x00 0x01 0x00 0x01 0x00 0x01 0x4d 0x01 0x00 0x00 0x00 0x00 0x01 0x4e 0x01 0x00 0x00 0x00 0x00 0x01 0x4f 0x01 0x00 0x00 0x01 0x01 0x01 0x50 0x01 0x00 0x00 0x00 0x00 0x01 0x51 0x01 0x00 0x00 0x00 0x00 0x01 0x52 0x01 0x00 0x00 0x01 0x01 0x01 0x53 0x01 0x00 0x00 0x01 0x00 0x01 0x54 0x00 0x01 0x00 0x01 0x00 0x01 0x55 0x00 0x01 0x00 0x01 0x00 0x01 0x56 0x01 0x00 0x00 0x01 0x00 0x00 0x57 0x01 0x00 0x00 0x01 0x00 0x00 0x58 0x01 0x00 0x00 0x01 0x00 0x00 0x59 0x01 0x00 0x00 0x01 0x00 0x00 0x5a 0x01 0x00 0x00 0x01 0x00 0x00 0x5b 0x01 0x00 0x00 0x01 0x00 0x00 0x5c 0x01 0x00 0x00 0x01 0x00 0x00 0x5d 0x01 0x00 0x00 0x01 0x00 0x00 0x5e 0x01 0x00 0x00 0x01 0x00 0x00 0x5f 0x01 0x00 0x00 0x01 0x00 0x00 0x60 0x01 0x00 0x00 0x01 0x00 0x00 0x61 0x01 0x00 0x00 0x01 0x00 0x00 0x62 0x01 0x00 0x00 0x01 0x00 0x00 0x63 0x01 0x00 0x00 0x01 0x00 0x00 0x64 0x01 0x00 0x00 0x01 0x00 0x00 0x65 0x01 0x00 0x00 0x01 0x00 0x00 0x66 0x01 0x00 0x00 0x01 0x00 0x00 0x67 0x01 0x00 0x00 0x01 0x00 0x00 0x68 0x01 0x00 0x00 0x01 0x00 0x00 0x69 0x01 0x00 0x00 0x01 0x00 0x00 0x6a 0x01 0x00 0x00 0x01 0x00 0x00 0x6b 0x01 0x00 0x00 0x01 0x00 0x00 0x6c 0x01 0x00 0x00 0x01 0x00 0x00 0x6d 0x01 0x00 0x00 0x01 0x00 0x00 0x6e 0x01 0x00 0x00 0x01 0x00 0x00 0x6f 0x01 0x00 0x00 0x01 0x00 0x00 0x70 0x01 0x00 0x00 0x01 0x00 0x00 0x71 0x01 0x00 0x00 0x01 0x00 0x00 0x72 0x01 0x00 0x00 0x01 0x00 0x00 0x73 0x01 0x00 0x00 0x01 0x00 0x00 0x74 0x01 0x00 0x00 0x00 0x00 0x00 0x75 0x00 0x00 0x00 0x01 0x00 0x00 0x76 0x00 0x01 0x01 0x00 0x00 0x00 0x77 0x01 0x00 0x00 0x01 0x00 0x00 0x78 0x01 0x00 0x00 0x01 0x00 0x00 0x79 0x01 0x00 0x00 0x01 0x00 0x00 0x7a 0x01 0x00 0x00 0x00 0x00 0x00 0x7b 0x01 0x00 0x00 0x00 0x00 0x00 0x7c 0x01 0x00 0x00 0x01 0x00 0x00 0x7d 0x01 0x00 0x00 0x01 0x00 0x00 0x7e 0x01 0x00 0x00 0x01 0x00 0x00 0x7f 0x01 0x00 0x00 0x01 0x00 0x00 0x80 0x01 0x00 0x00 0x01 0x00 0x00 0x81 0x01 0x00 0x00 0x01 0x00 0x00 0x82 0x01 0x00 0x00 0x01 0x01 0x01 0x83 0x01 0x00 0x00 0x01 0x01 0x01 0x84 0x02 0x00 0x00 0x01 0x01 0x00 0x85 0x02 0x00 0x00 0x01 0x01 0x00 0x86 0x01 0x00 0x00 0x01 0x01 0x01 0x87 0x01 0x00 0x00 0x01 0x01 0x01 0x88 0x01 0x00 0x00 0x01 0x01 0x01 0x89 0x01 0x00 0x00 0x01 0x01 0x01 0x8a 0x01 0x00 0x00 0x01 0x01 0x01 0x8b 0x01 0x00 0x00 0x01 0x01 0x01 0x8c 0x01 0x00 0x00 0x01 0x01 0x01 0x8d 0x01 0x00 0x00 0x01 0x01 0x01 0x8e 0x01 0x00 0x00 0x01 0x01 0x01 0x8f 0x01 0x00 0x00 0x01 0x01 0x01 0x90 0x01 0x00 0x00 0x01 0x01 0x01 0x91 0x01 0x00 0x00 0x01 0x01 0x01 0x92 0x01 0x00 0x00 0x01 0x01 0x01 0x93 0x01 0x00 0x00 0x01 0x01 0x01 0x94 0x02 0x00 0x00 0x01 0x01 0x01 0x95 0x02 0x00 0x00 0x01 0x01 0x01 0x96 0x00 0x01 0x00 0x01 0x00 0x01 0x97 0x00 0x01 0x00 0x01 0x00 0x01 0x98 0x00 0x01 0x00 0x01 0x00 0x01 0x99 0x00 0x01 0x00 0x01 0x00 0x01 0x9a 0x00 0x01 0x00 0x01 0x00 0x01 0x9b 0x00 0x01 0x00 0x01 0x00 0x01 0x9c 0x00 0x01 0x00 0x01 0x00 0x01 0x9d 0x00 0x01 0x00 0x01 0x00 0x01 0x9e 0x00 0x01 0x00 0x01 0x00 0x00 0x9f 0x02 0x00 0x00 0x01 0x00 0x00 0xa0 0x01 0x00 0x00 0x00 0x00 0x01 0xa1 0x01 0x00 0x00 0x00 0x00 0x01 0xa2 0x01 0x00 0x00 0x00 0x00 0x01 0xa3 0x01 0x00 0x00 0x01 0x00 0x01 0xa4 0x01 0x00 0x00 0x00 0x00 0x01 0xa5 0x01 0x00 0x00 0x00 0x00 0x01 0xa6 0x01 0x00 0x00 0x00 0x00 0x01 0xa7 0x01 0x00 0x00 0x01 0x00 0x01 0xa8 0x01 0x00 0x00 0x00 0x00 0x00 0xa9 0x01 0x00 0x00 0x00 0x00 0x01 0xaa 0x01 0x00 0x00 0x00 0x00 0x01 0xab 0x01 0x00 0x00 0x00 0x00 0x01 0xac 0x01 0x00 0x00 0x00 0x00 0x01 0xad 0x01 0x00 0x00 0x01 0x00 0x01 0xae 0x01 0x00 0x00 0x01 0x00 0x01 0xaf 0x01 0x00 0x00 0x01 0x00 0x01 0xb0 0x01 0x00 0x00 0x01 0x00 0x01 0xb1 0x00 0x00 0x00 0x01 0x00 0x00 0xb2 0x00 0x00 0x00 0x01 0x00 0x00 0xb3 0x00 0x00 0x00 0x01 0x00 0x00 0xb4 0x00 0x00 0x00 0x01 0x00 0x00 0xb5 0x00 0x00 0x00 0x01 0x00 0x00 0xb6 0x00 0x00 0x00 0x01 0x00 0x00 0xb7 0x00 0x00 0x00 0x01 0x00 0x00 0xb8 0x00 0x00 0x00 0x01 0x00 0x00 0xb9 0x00 0x00 0x00 0x01 0x00 0x00 0xba 0x01 0x00 0x00 0x01 0x01 0x01 0xbb 0x01 0x00 0x00 0x01 0x01 0x01 0xbc 0x00 0x00 0x00 0x01 0x00 0x00 0xbd 0x00 0x00 0x00 0x01 0x00 0x00 0xbe 0x00 0x00 0x00 0x01 0x00 0x00 0xbf 0x00 0x00 0x00 0x01 0x00 0x00 0xc0 0x00 0x00 0x00 0x01 0x00 0x00 0xc1 0x00 0x00 0x00 0x01 0x00 0x00 0xc2 0x00 0x00 0x00 0x01 0x00 0x00 0xc3 0x00 0x00 0x00 0x01 0x00 0x00 0xc4 0x00 0x00 0x00 0x01 0x00 0x00 0xc5 0x00 0x00 0x00 0x01 0x00 0x00 0xc6 0x00 0x00 0x00 0x01 0x00 0x00 0xc7 0x00 0x00 0x00 0x01 0x00 0x00 0xc8 0x00 0x00 0x00 0x01 0x00 0x00 0xc9 0x00 0x00 0x00 0x01 0x00 0x00 0xca 0x00 0x00 0x00 0x01 0x00 0x00 0xcb 0x00 0x00 0x00 0x01 0x00 0x00 0xcc 0x00 0x00 0x00 0x01 0x00 0x00 0xcd 0x00 0x00 0x00 0x01 0x00 0x00 0xce 0x00 0x00 0x00 0x01 0x00 0x00 0xcf 0x00 0x00 0x00 0x01 0x00 0x00 0xd0 0x00 0x00 0x00 0x01 0x00 0x00 0xd1 0x00 0x00 0x00 0x01 0x00 0x00 0xd2 0x00 0x00 0x00 0x01 0x00 0x00 0xd3 0x00 0x00 0x00 0x01 0x00 0x00 0xd4 0x00 0x00 0x00 0x01 0x00 0x00 0xd5 0x00 0x00 0x00 0x01 0x00 0x00 0xd6 0x00 0x00 0x00 0x01 0x00 0x00 0xd7 0x00 0x00 0x00 0x01 0x00 0x00 0xd8 0x00 0x00 0x00 0x01 0x00 0x00 0xd9 0x00 0x00 0x00 0x01 0x00 0x00 0xda 0x00 0x00 0x00 0x01 0x00 0x00 0xdb 0x00 0x00 0x00 0x01 0x00 0x00 0xdc 0x00 0x00 0x00 0x01 0x00 0x00 0xdd 0x00 0x00 0x00 0x01 0x00 0x00>;
		};
	};

	fragment@51 {
		target = <0xffffffff>;

		__overlay__ {
			interrupt-parent = <0xffffffff>;
			interrupts = <0x05 0x02>;
			status = "okay";
		};
	};

	fragment@52 {
		target = <0xffffffff>;

		__overlay__ {
			interrupt-parent = <0xffffffff>;
			interrupts = <0x06 0x08>;
			status = "okay";
		};
	};

	fragment@53 {
		target = <0xffffffff>;

		__overlay__ {
			interrupt-parent = <0xffffffff>;
			interrupts = <0x09 0x02>;
			status = "okay";
		};
	};

	fragment@54 {
		target = <0xffffffff>;

		__overlay__ {
			interrupt-parent = <0xffffffff>;
			interrupts = <0x53 0x01>;
			status = "okay";
		};
	};

	fragment@55 {
		target = <0xffffffff>;

		__overlay__ {
			compatible = "mediatek,md1_sim1_hot_plug_eint-eint";
			interrupts = <0x00 0x08>;
			debounce = <0x00 0x4e20>;
			dedicated = <0x00 0x00>;
			src_pin = <0x00 0x01>;
			sockettype = <0x00 0x00>;
			status = "okay";
		};
	};

	fragment@56 {
		target = <0xffffffff>;

		__overlay__ {
			mediatek,key-debounce = <0x400>;
			mediatek,sw-pwrkey = <0x74>;
			mediatek,hw-pwrkey = <0x08>;
			mediatek,use-extend-type = <0x00>;
			mediatek,hw-map-num = <0x48>;
			mediatek,hw-init-map = <0x73 0x72 0x00 0x00 0x00 0x00 0x00 0x00 0x00 0x00 0x00 0x00 0x00 0x00 0x00 0x00 0x00 0x00 0x00 0x00 0x00 0x00 0x00 0x00 0x00 0x00 0x00 0x00 0x00 0x00 0x00 0x00 0x00 0x00 0x00 0x00 0x00 0x00 0x00 0x00 0x00 0x00 0x00 0x00 0x00 0x00 0x00 0x00 0x00 0x00 0x00 0x00 0x00 0x00 0x00 0x00 0x00 0x00 0x00 0x00 0x00 0x00 0x00 0x00 0x00 0x00 0x00 0x00 0x00 0x00 0x00 0x00>;
			mediatek,pwrkey-eint-gpio = <0x00>;
			mediatek,pwkey-gpio-din = <0x00>;
			mediatek,hw-dl-key0 = <0x00>;
			mediatek,hw-dl-key1 = <0x01>;
			mediatek,hw-dl-key2 = <0x08>;
			mediatek,hw-recovery-key = <0x00>;
			mediatek,hw-factory-key = <0x01>;
			status = "okay";
		};
	};

	fragment@57 {
		target = <0xffffffff>;

		__overlay__ {

			camera_pins_cam0_mclk_off {
				phandle = <0x2c>;

				pins_cmd_dat {
					pinmux = <0x8100>;
					drive-strength = <0x01>;
				};
			};

			camera_pins_cam0_mclk_2ma {
				phandle = <0x2d>;

				pins_cmd_dat {
					pinmux = <0x8101>;
					drive-strength = <0x00>;
				};
			};

			camera_pins_cam0_mclk_4ma {
				phandle = <0x2e>;

				pins_cmd_dat {
					pinmux = <0x8101>;
					drive-strength = <0x01>;
				};
			};

			camera_pins_cam0_mclk_6ma {
				phandle = <0x2f>;

				pins_cmd_dat {
					pinmux = <0x8101>;
					drive-strength = <0x02>;
				};
			};

			camera_pins_cam0_mclk_8ma {
				phandle = <0x30>;

				pins_cmd_dat {
					pinmux = <0x8101>;
					drive-strength = <0x03>;
				};
			};

			camera_pins_cam1_mclk_off {
				phandle = <0x31>;

				pins_cmd_dat {
					pinmux = <0x7e00>;
					drive-strength = <0x01>;
				};
			};

			camera_pins_cam1_mclk_2ma {
				phandle = <0x32>;

				pins_cmd_dat {
					pinmux = <0x7e01>;
					drive-strength = <0x00>;
				};
			};

			camera_pins_cam1_mclk_4ma {
				phandle = <0x33>;

				pins_cmd_dat {
					pinmux = <0x7e01>;
					drive-strength = <0x01>;
				};
			};

			camera_pins_cam1_mclk_6ma {
				phandle = <0x34>;

				pins_cmd_dat {
					pinmux = <0x7e01>;
					drive-strength = <0x02>;
				};
			};

			camera_pins_cam1_mclk_8ma {
				phandle = <0x35>;

				pins_cmd_dat {
					pinmux = <0x7e01>;
					drive-strength = <0x03>;
				};
			};

			camdefault {
				phandle = <0x2b>;
			};
		};
	};

	fragment@58 {
		target = <0xffffffff>;

		__overlay__ {
			pinctrl-names = "default\0cam0_mclk_off\0cam0_mclk_2mA\0cam0_mclk_4mA\0cam0_mclk_6mA\0cam0_mclk_8mA\0cam1_mclk_off\0cam1_mclk_2mA\0cam1_mclk_4mA\0cam1_mclk_6mA\0cam1_mclk_8mA";
			pinctrl-0 = <0x2b>;
			pinctrl-1 = <0x2c>;
			pinctrl-2 = <0x2d>;
			pinctrl-3 = <0x2e>;
			pinctrl-4 = <0x2f>;
			pinctrl-5 = <0x30>;
			pinctrl-6 = <0x31>;
			pinctrl-7 = <0x32>;
			pinctrl-8 = <0x33>;
			pinctrl-9 = <0x34>;
			pinctrl-10 = <0x35>;
			cam0_pin_mclk = "mclk";
			cam0_pin_rst = "regulator";
			cam0_pin_vs2pmu = "regulator";
			cam0_pin_vcama = "regulator";
			cam0_pin_vcamd = "regulator";
			cam0_pin_vcamio = "regulator";
			cam0_pin_vcamaf = "regulator";
			cam1_pin_mclk = "mclk";
			cam1_pin_rst = "regulator";
			cam1_pin_vs2pmu = "regulator";
			cam1_pin_vcama = "regulator";
			cam1_pin_vcamd = "regulator";
			cam1_pin_vcamio = "regulator";
			cam2_pin_vcama = "regulator";
			cam0_vcama-supply = <0x36>;
			cam0_vcamd-supply = <0x37>;
			cam0_vcamio-supply = <0x38>;
			cam0_vcamrst-supply = <0x39>;
			cam0_vcamaf-supply = <0xffffffff>;
			cam1_vcama-supply = <0x3a>;
			cam1_vcamd-supply = <0x3b>;
			cam1_vcamio-supply = <0x38>;
			cam1_vcamrst-supply = <0x3c>;
			cam2_vcama-supply = <0x3a>;
			cam0_enable_sensor = "imx882_mipi_raw";
			cam1_enable_sensor = "gc13a0ff_mipi_raw";
			cam2_enable_sensor = "fake_serial_yuv";
			camera_input_gpio = <0xffffffff 0x16 0x00>;
			status = "okay";
		};
	};

	fragment@59 {
		target = <0xffffffff>;

		__overlay__ {

			flashlight_gpio157 {
				compatible = "regulator-fixed";
				regulator-name = "flashlight_gpio157";
				regulator-min-microvolt = <0x1b7740>;
				regulator-max-microvolt = <0x1b7740>;
				gpio = <0xffffffff 0x9d 0x00>;
				enable-active-high;
				phandle = <0x3d>;
			};

			flashlight_gpio64 {
				compatible = "regulator-fixed";
				regulator-name = "flashlight_gpio64";
				regulator-min-microvolt = <0x1b7740>;
				regulator-max-microvolt = <0x1b7740>;
				gpio = <0xffffffff 0x40 0x00>;
				enable-active-high;
				phandle = <0x3e>;
			};

			flashlight_gpio63 {
				compatible = "regulator-fixed";
				regulator-name = "flashlight_gpio63";
				regulator-min-microvolt = <0x1b7740>;
				regulator-max-microvolt = <0x1b7740>;
				gpio = <0xffffffff 0x3f 0x00>;
				enable-active-high;
				phandle = <0x3f>;
			};

			cam0vcamio_gpio62 {
				compatible = "regulator-fixed";
				regulator-name = "cam0vcamio_gpio62";
				regulator-min-microvolt = <0x1b7740>;
				regulator-max-microvolt = <0x1b7740>;
				gpio = <0xffffffff 0x3e 0x00>;
				enable-active-high;
				phandle = <0x38>;
			};

			cam0rst_gpio18 {
				compatible = "regulator-fixed";
				regulator-name = "cam0rst_gpio18";
				regulator-min-microvolt = <0x1b7740>;
				regulator-max-microvolt = <0x1b7740>;
				gpio = <0xffffffff 0x12 0x00>;
				enable-active-high;
				phandle = <0x39>;
			};

			cam1rst_gpio16 {
				compatible = "regulator-fixed";
				regulator-name = "cam1rst_gpio16";
				regulator-min-microvolt = <0x1b7740>;
				regulator-max-microvolt = <0x1b7740>;
				gpio = <0xffffffff 0x10 0x00>;
				enable-active-high;
				phandle = <0x3c>;
			};

			cam1vcamd_gpio46 {
				compatible = "regulator-fixed";
				regulator-name = "cam1vcamd_gpio46";
				regulator-min-microvolt = <0x1b7740>;
				regulator-max-microvolt = <0x1b7740>;
				gpio = <0xffffffff 0x2e 0x00>;
				enable-active-high;
				phandle = <0x3b>;
			};

			fakesensor {
				compatible = "transsion,fakesensor";
				sensor_matecodes = "alspdt17_17201873";
				sensor_index = "2";
				fakevin-supply = <0x3a>;
				fakesensor_output = <0xffffffff 0x16 0x00>;
				phandle = <0x61>;
			};

			camera_af_gpio {
				compatible = "regulator-fixed";
				regulator-name = "camera_af_gpio";
				regulator-min-microvolt = <0x1b7740>;
				regulator-max-microvolt = <0x1b7740>;
				gpio = <0xffffffff 0x2f 0x00>;
				enable-active-high;
				phandle = <0x62>;
			};
		};
	};

	fragment@60 {
		target = <0xffffffff>;

		__overlay__ {
			status = "okay";
			clock-frequency = <0xf4240>;
			#address-cells = <0x01>;
			#size-cells = <0x00>;

			camera_eeprom0@50 {
				compatible = "mediatek,camera_eeprom";
				rw_unlock_reg = <0xa000 0x00 0xa000 0x0e>;
				reg = <0x50>;
				status = "okay";
				phandle = <0x63>;
			};

			camera_main@2a {
				compatible = "mediatek,camera_main";
				#thermal-sensor-cells = <0x00>;
				sensor-matecodes = "imx882_17201983";
				project-name = "tran_x6886";
				reg = <0x2a>;
				status = "okay";
				phandle = <0x40>;
			};

			camera_main_af@0c {
				compatible = "mediatek,camera_main_af";
				reg = <0x0c>;
				status = "okay";
				phandle = <0x64>;
			};
		};
	};

	fragment@61 {
		target = <0xffffffff>;

		__overlay__ {
			status = "okay";
			clock-frequency = <0xf4240>;
			#address-cells = <0x01>;
			#size-cells = <0x00>;

			camera_eeprom1@51 {
				compatible = "mediatek,camera_eeprom";
				reg = <0x51>;
				status = "okay";
				phandle = <0x65>;
			};

			camera_sub@1a {
				compatible = "mediatek,camera_sub";
				#thermal-sensor-cells = <0x00>;
				sensor-matecodes = "gc13a0_17201982";
				project-name = "tran_x6886";
				reg = <0x1a>;
				status = "okay";
				phandle = <0x41>;
			};
		};
	};

	fragment@62 {
		target = <0xffffffff>;

		__overlay__ {
			#address-cells = <0x01>;
			#size-cells = <0x00>;
			clock-frequency = <0x61a80>;
			mediatek,use-open-drain;

			flashlights_tran@63 {
				compatible = "mediatek,flashlights_tran";
				reg = <0x63>;
				#cooling-cells = <0x02>;
				flash_type = <0x01>;
				tran_regulator-supply = <0x3d>;
				back-supply = <0x3e>;
				back_warm-supply = <0x3f>;
				status = "okay";
				phandle = <0x66>;

				flashlights_tran@0 {
					type = <0x00>;
					ct = <0x00>;
					part = <0x00>;
					ch = <0x00>;
					decouple = <0x00>;
				};

				flashlights_tran@1 {
					type = <0x01>;
					ct = <0x00>;
					part = <0x00>;
					ch = <0x01>;
					decouple = <0x00>;
				};

				flashlights_tran@2 {
					type = <0x00>;
					ct = <0x01>;
					part = <0x00>;
					ch = <0x02>;
					decouple = <0x00>;
				};
			};
		};
	};

	fragment@63 {
		target = <0xffffffff>;

		__overlay__ {

			camera_main {
				polling-delay = <0x3e8>;
				polling-delay-passive = <0x00>;
				thermal-sensors = <0x40>;
				phandle = <0x67>;
			};

			camera_sub {
				polling-delay = <0x3e8>;
				polling-delay-passive = <0x00>;
				thermal-sensors = <0x41>;
				phandle = <0x68>;
			};
		};
	};

	fragment@64 {
		target = <0xffffffff>;

		__overlay__ {

			sd_tray {
				sdtray_enable = <0x01>;
				status = "ok";
			};
		};
	};

	__symbols__ {
		TRANLDO13 = "/fragment@2/__overlay__/tran_ldo@28/regulators/TRANLDO13";
		TRANLDO23 = "/fragment@2/__overlay__/tran_ldo@28/regulators/TRANLDO23";
		TRANLDO33 = "/fragment@2/__overlay__/tran_ldo@28/regulators/TRANLDO33";
		TRANLDO43 = "/fragment@2/__overlay__/tran_ldo@28/regulators/TRANLDO43";
		hl1280 = "/fragment@2/__overlay__/hl1280-audioswitch@42";
		mtkfb_pins_lcm_reset0 = "/fragment@3/__overlay__/lcm_rst_out0_gpio";
		mtkfb_pins_lcm_reset1 = "/fragment@3/__overlay__/lcm_rst_out1_gpio";
		mtkfb_pins_lcm_dsi_te = "/fragment@3/__overlay__/lcm_dsi_te";
		mtkfb_pins_default = "/fragment@3/__overlay__/dispdefault";
		panel_in1 = "/fragment@6/__overlay__/panel1@0/port/endpoint";
		panel_in2 = "/fragment@6/__overlay__/panel2@0/port/endpoint";
		dsi_out = "/fragment@6/__overlay__/ports/port/endpoint";
		tran_audio_controller = "/fragment@7/__overlay__/tran_audio_controller";
		tms_nfc = "/fragment@9/__overlay__/tms_nfc@28";
		blkio = "/fragment@10/__overlay__/blkio";
		gps_pins_default = "/fragment@11/__overlay__/gps_default";
		gps_l1_lna_pins_ol = "/fragment@11/__overlay__/gps_l1_lna@0";
		gps_l1_lna_pins_dsp_ctrl = "/fragment@11/__overlay__/gps_l1_lna@1";
		gps_l1_lna_pins_oh = "/fragment@11/__overlay__/gps_l1_lna@2";
		gps_l5_lna_pins_ol = "/fragment@11/__overlay__/gps_l5_lna@0";
		gps_l5_lna_pins_dsp_ctrl = "/fragment@11/__overlay__/gps_l5_lna@1";
		gps_l5_lna_pins_oh = "/fragment@11/__overlay__/gps_l5_lna@2";
		tran_touch = "/fragment@16/__overlay__/touch@0";
		ctp_pins_default = "/fragment@17/__overlay__/ctp_default";
		ctp_pins_spi_mode = "/fragment@17/__overlay__/ctp_spimode_default";
		usb_control = "/fragment@21/__overlay__/usb_control";
		usb_control_default = "/fragment@22/__overlay__/usb_control_default";
		hvdcp_handshake = "/fragment@22/__overlay__/hvdcp_handshake";
		hvdcp_boost_5v = "/fragment@22/__overlay__/hvdcp_boost_5v";
		hvdcp_boost_9v = "/fragment@22/__overlay__/hvdcp_boost_9v";
		hvdcp_reset = "/fragment@22/__overlay__/hvdcp_reset";
		tc30_handshake = "/fragment@22/__overlay__/tc30_handshake";
		tc30_reset = "/fragment@22/__overlay__/tc30_reset";
		rfc_i2c_mode = "/fragment@22/__overlay__/rfc_i2c_mode";
		rfc_dual_high = "/fragment@22/__overlay__/rfc_dual_high";
		rfc_high_low = "/fragment@22/__overlay__/rfc_high_low";
		rfc_reset = "/fragment@22/__overlay__/rfc_reset";
		rfc_usb_switch_on = "/fragment@22/__overlay__/usb_switch_on";
		rfc_usb_switch_off = "/fragment@22/__overlay__/usb_switch_off";
		ta_off = "/fragment@22/__overlay__/ta_off";
		ta_reset = "/fragment@22/__overlay__/ta_reset";
		switch_chg = "/fragment@25/__overlay__/sc-swchg@6b";
		otg_vbus = "/fragment@25/__overlay__/sc-swchg@6b/usb-otg-vbus";
		tc_pd_adapter = "/fragment@26/__overlay__/tc_pd_adapter";
		gpio_i2c_sclk_mode = "/fragment@28/__overlay__/i2c_sclk_mode";
		gpio_i2c_sda_mode = "/fragment@28/__overlay__/i2c_sda_mode";
		usb_role = "/fragment@30/__overlay__/port/endpoint@0";
		tran_otg = "/fragment@32/__overlay__/tran_otg";
		tc_trancare = "/fragment@32/__overlay__/tc_trancare";
		tc_audio = "/fragment@32/__overlay__/tc_audio";
		water_detect = "/fragment@32/__overlay__/water_detect";
		port_corrosion = "/fragment@32/__overlay__/port_corrosion";
		phy_insert_det = "/fragment@32/__overlay__/phy_insert_det";
		tc_pmic = "/fragment@32/__overlay__/tc_pmic";
		tc_chgtype = "/fragment@32/__overlay__/tc_chgtype";
		tc_gauge = "/fragment@32/__overlay__/tc_gauge";
		tc_misc = "/fragment@32/__overlay__/tc_misc";
		tc_lcd = "/fragment@32/__overlay__/tc_lcd";
		tc_pe2 = "/fragment@32/__overlay__/tc_pe2";
		tc_30 = "/fragment@32/__overlay__/tc_30";
		tc_hvdcp20 = "/fragment@32/__overlay__/tc_hvdcp20";
		tc_pd = "/fragment@32/__overlay__/tc_pd";
		tc_auto_test = "/fragment@32/__overlay__/tc_auto_test";
		pid_chg = "/fragment@32/__overlay__/pid_chg";
		ambient_detect = "/fragment@32/__overlay__/ambient_detect";
		temp_forecast = "/fragment@32/__overlay__/temp_forecast";
		tc_tcpc = "/fragment@32/__overlay__/tc_tcpc";
		tc_adapter_control = "/fragment@32/__overlay__/tc_adapter_control";
		spk = "/fragment@38/__overlay__/speaker_amp@5c";
		fingerprint = "/fragment@41/__overlay__/fingerprint";
		fingerprint_default = "/fragment@43/__overlay__/fingerprint_default";
		fingerprint_eint = "/fragment@43/__overlay__/gpio13_eint";
		fingerprint_eint_pull_down = "/fragment@43/__overlay__/gpio13_eint_pull_down";
		fingerprint_rst_one = "/fragment@43/__overlay__/rst_out_one";
		fingerprint_rst_zero = "/fragment@43/__overlay__/rst_out_zero";
		fingerprint_spi_default = "/fragment@43/__overlay__/spimode_default";
		camera_pins_cam0_mclk_off = "/fragment@57/__overlay__/camera_pins_cam0_mclk_off";
		camera_pins_cam0_mclk_2ma = "/fragment@57/__overlay__/camera_pins_cam0_mclk_2ma";
		camera_pins_cam0_mclk_4ma = "/fragment@57/__overlay__/camera_pins_cam0_mclk_4ma";
		camera_pins_cam0_mclk_6ma = "/fragment@57/__overlay__/camera_pins_cam0_mclk_6ma";
		camera_pins_cam0_mclk_8ma = "/fragment@57/__overlay__/camera_pins_cam0_mclk_8ma";
		camera_pins_cam1_mclk_off = "/fragment@57/__overlay__/camera_pins_cam1_mclk_off";
		camera_pins_cam1_mclk_2ma = "/fragment@57/__overlay__/camera_pins_cam1_mclk_2ma";
		camera_pins_cam1_mclk_4ma = "/fragment@57/__overlay__/camera_pins_cam1_mclk_4ma";
		camera_pins_cam1_mclk_6ma = "/fragment@57/__overlay__/camera_pins_cam1_mclk_6ma";
		camera_pins_cam1_mclk_8ma = "/fragment@57/__overlay__/camera_pins_cam1_mclk_8ma";
		camera_pins_default = "/fragment@57/__overlay__/camdefault";
		flashlight_gpio157 = "/fragment@59/__overlay__/flashlight_gpio157";
		flashlight_gpio64 = "/fragment@59/__overlay__/flashlight_gpio64";
		flashlight_gpio63 = "/fragment@59/__overlay__/flashlight_gpio63";
		cam0vcamio_gpio62 = "/fragment@59/__overlay__/cam0vcamio_gpio62";
		cam0rst_gpio18 = "/fragment@59/__overlay__/cam0rst_gpio18";
		cam1rst_gpio16 = "/fragment@59/__overlay__/cam1rst_gpio16";
		cam1vcamd_gpio46 = "/fragment@59/__overlay__/cam1vcamd_gpio46";
		fakesensor = "/fragment@59/__overlay__/fakesensor";
		camera_af_gpio = "/fragment@59/__overlay__/camera_af_gpio";
		mtk_camera_eeprom0 = "/fragment@60/__overlay__/camera_eeprom0@50";
		camera_main_mtk = "/fragment@60/__overlay__/camera_main@2a";
		camera_main_af_mtk = "/fragment@60/__overlay__/camera_main_af@0c";
		mtk_camera_eeprom1 = "/fragment@61/__overlay__/camera_eeprom1@51";
		camera_sub_mtk = "/fragment@61/__overlay__/camera_sub@1a";
		flashlights_tran = "/fragment@62/__overlay__/flashlights_tran@63";
		camera_main = "/fragment@63/__overlay__/camera_main";
		camera_sub = "/fragment@63/__overlay__/camera_sub";
	};

	__fixups__ {
		chosen = "/fragment@0:target:0\0/fragment@26/__overlay__/tc_pd_adapter:boot_mode:0\0/fragment@32/__overlay__/water_detect:bootmode:0\0/fragment@32/__overlay__/tc_misc:bootmode:0";
		mtk_leds = "/fragment@1:target:0";
		i2c3 = "/fragment@2:target:0\0/fragment@24:target:0";
		pio = "/fragment@3:target:0\0/fragment@6/__overlay__/panel1@0:vddi-gpios:0\0/fragment@6/__overlay__/panel1@0:vci-gpios:0\0/fragment@6/__overlay__/panel1@0:reset-gpios:0\0/fragment@6/__overlay__/panel2@0:vddi-gpios:0\0/fragment@6/__overlay__/panel2@0:vci-gpios:0\0/fragment@6/__overlay__/panel2@0:reset-gpios:0\0/fragment@7/__overlay__/tran_audio_controller:typec_usb_change_gpio:0\0/fragment@9/__overlay__/tms_nfc@28:tms,irq-gpio:0\0/fragment@9/__overlay__/tms_nfc@28:tms,ven-gpio:0\0/fragment@9/__overlay__/tms_nfc@28:tms,download-gpio:0\0/fragment@11:target:0\0/fragment@16/__overlay__/touch@0:interrupt-parent:0\0/fragment@16/__overlay__/touch@0:focaltech,iovdd-gpio:0\0/fragment@16/__overlay__/touch@0:focaltech,irq-gpio:0\0/fragment@16/__overlay__/touch@0:focaltech,reset-gpio:0\0/fragment@16/__overlay__/touch@0:focaltech,avdd-gpio:0\0/fragment@16/__overlay__/touch@0:chipsemi,int-gpio:0\0/fragment@16/__overlay__/touch@0:chipsemi,rst-gpio:0\0/fragment@16/__overlay__/touch@0:chipsemi,vdd-gpio:0\0/fragment@16/__overlay__/touch@0:chipsemi,vddio-gpio:0\0/fragment@17:target:0\0/fragment@19/__overlay__/sc8548_master@6F:sc8548,intr-gpios:0\0/fragment@20/__overlay__/hl7139a_master@5f:hl7139a,intr-gpios:0\0/fragment@22:target:0\0/fragment@24/__overlay__/upm7610@60:upm7610pd,intr-gpio:0\0/fragment@25/__overlay__/sc-swchg@6b:sc8950,intr_gpio:0\0/fragment@28:target:0\0/fragment@32/__overlay__/phy_insert_det:phy,intr-gpio:0\0/fragment@41/__overlay__/fingerprint:interrupt-parent:0\0/fragment@42/__overlay__/fingerprint@0:interrupt-parent:0\0/fragment@42/__overlay__/fingerprint@0:irq-gpio-std:0\0/fragment@42/__overlay__/fingerprint@0:reset-gpio-std:0\0/fragment@42/__overlay__/fingerprint@0:tran,gpio_pwr-std:0\0/fragment@43:target:0\0/fragment@49/__overlay__:GPIO_SIM1_HOT_PLUG:0\0/fragment@49/__overlay__:GPIO_SIM1_SCLK:0\0/fragment@49/__overlay__:GPIO_SIM1_SRST:0\0/fragment@49/__overlay__:GPIO_SIM1_SIO:0\0/fragment@49/__overlay__:GPIO_SIM2_SCLK:0\0/fragment@49/__overlay__:GPIO_SIM2_SRST:0\0/fragment@49/__overlay__:GPIO_SIM2_SIO:0\0/fragment@51/__overlay__:interrupt-parent:0\0/fragment@52/__overlay__:interrupt-parent:0\0/fragment@53/__overlay__:interrupt-parent:0\0/fragment@54/__overlay__:interrupt-parent:0\0/fragment@57:target:0\0/fragment@58/__overlay__:camera_input_gpio:0\0/fragment@59/__overlay__/flashlight_gpio157:gpio:0\0/fragment@59/__overlay__/flashlight_gpio64:gpio:0\0/fragment@59/__overlay__/flashlight_gpio63:gpio:0\0/fragment@59/__overlay__/cam0vcamio_gpio62:gpio:0\0/fragment@59/__overlay__/cam0rst_gpio18:gpio:0\0/fragment@59/__overlay__/cam1rst_gpio16:gpio:0\0/fragment@59/__overlay__/cam1vcamd_gpio46:gpio:0\0/fragment@59/__overlay__/fakesensor:fakesensor_output:0\0/fragment@59/__overlay__/camera_af_gpio:gpio:0";
		mtkfb = "/fragment@4:target:0";
		dispsys_config = "/fragment@5:target:0";
		dsi0 = "/fragment@6:target:0";
		odm = "/fragment@7:target:0\0/fragment@10:target:0\0/fragment@21:target:0\0/fragment@26:target:0\0/fragment@32:target:0\0/fragment@41:target:0\0/fragment@59:target:0\0/fragment@64:target:0";
		i2c6 = "/fragment@8:target:0\0/fragment@38:target:0\0/fragment@62:target:0";
		i2c0 = "/fragment@9:target:0";
		gps = "/fragment@12:target:0";
		mt6366keys = "/fragment@13:target:0";
		regulator_vibrator = "/fragment@14:target:0";
		touch = "/fragment@15:target:0\0/fragment@53:target:0";
		spi1 = "/fragment@16:target:0";
		mt6358_vmch_reg = "/fragment@16/__overlay__/touch@0:vtouch-supply:0";
		mtk_gauge = "/fragment@18:target:0\0/fragment@32/__overlay__/tc_gauge:gauge:0\0/fragment@34:target:0";
		i2c7 = "/fragment@19:target:0\0/fragment@20:target:0\0/fragment@27:target:0";
		pe5 = "/fragment@23:target:0";
		i2c5 = "/fragment@25:target:0";
		u2port0 = "/fragment@25/__overlay__/sc-swchg@6b:phys:0\0/fragment@26/__overlay__/tc_pd_adapter:phys:0\0/fragment@31:target:0\0/fragment@32/__overlay__/tc_chgtype:phys:0";
		usb = "/fragment@25/__overlay__/sc-swchg@6b:usb:0\0/fragment@32/__overlay__/tc_chgtype:usb:0";
		mt6375_chg = "/fragment@29:target:0";
		extcon_usb = "/fragment@30:target:0";
		musb_drd_switch = "/fragment@30/__overlay__/port/endpoint@0:remote-endpoint:0";
		pmic_auxadc = "/fragment@32/__overlay__/tc_pmic:io-channels:0";
		auxadc = "/fragment@32/__overlay__/tc_misc:io-channels:0\0/fragment@48:target:0";
		charger = "/fragment@33:target:0";
		mt6375_typec = "/fragment@35:target:0";
		battery_manager = "/fragment@36:target:0";
		lk_charger = "/fragment@37:target:0";
		sound = "/fragment@39:target:0";
		pdc = "/fragment@40:target:0";
		spi3 = "/fragment@42:target:0";
		mmc1 = "/fragment@44:target:0";
		tran_sensor_cust = "/fragment@45:target:0";
		irtx_pwm = "/fragment@46:target:0";
		mobicore = "/fragment@47:target:0";
		gpio_usage_mapping = "/fragment@49:target:0";
		gpio = "/fragment@50:target:0";
		rt5133_eint = "/fragment@51:target:0";
		smart_pa = "/fragment@52:target:0";
		dsi_te = "/fragment@54:target:0";
		md1_sim1_hot_plug_eint = "/fragment@55:target:0";
		keypad = "/fragment@56:target:0";
		kd_camera_hw1 = "/fragment@58:target:0";
		mt6358_vio28_reg = "/fragment@58/__overlay__:cam0_vcamaf-supply:0";
		i2c2 = "/fragment@60:target:0";
		i2c4 = "/fragment@61:target:0";
		thermal_zones = "/fragment@63:target:0";
	};

	__local_fixups__ {

		fragment@4 {

			__overlay__ {
				pinctrl-0 = <0x00>;
				pinctrl-1 = <0x00>;
				pinctrl-2 = <0x00>;
				pinctrl-3 = <0x00>;
			};
		};

		fragment@5 {

			__overlay__ {
				pinctrl-0 = <0x00>;
				pinctrl-1 = <0x00>;
				pinctrl-2 = <0x00>;
				pinctrl-3 = <0x00>;
			};
		};

		fragment@6 {

			__overlay__ {

				panel1@0 {
					dvdd-supply = <0x00>;

					port {

						endpoint {
							remote-endpoint = <0x00>;
						};
					};
				};

				panel2@0 {
					dvdd-supply = <0x00>;

					port {

						endpoint {
							remote-endpoint = <0x00>;
						};
					};
				};

				ports {

					port {

						endpoint {
							remote-endpoint = <0x00>;
						};
					};
				};
			};
		};

		fragment@12 {

			__overlay__ {
				pinctrl-0 = <0x00>;
				pinctrl-1 = <0x00>;
				pinctrl-2 = <0x00>;
				pinctrl-3 = <0x00>;
				pinctrl-4 = <0x00>;
				pinctrl-5 = <0x00>;
				pinctrl-6 = <0x00>;
			};
		};

		fragment@16 {

			__overlay__ {

				touch@0 {
					pinctrl-0 = <0x00>;
					pinctrl-1 = <0x00>;
				};
			};
		};

		fragment@21 {

			__overlay__ {

				usb_control {
					pinctrl-0 = <0x00>;
					pinctrl-1 = <0x00>;
					pinctrl-2 = <0x00>;
					pinctrl-3 = <0x00>;
					pinctrl-4 = <0x00>;
					pinctrl-5 = <0x00>;
					pinctrl-6 = <0x00>;
					pinctrl-7 = <0x00>;
					pinctrl-8 = <0x00>;
					pinctrl-9 = <0x00>;
					pinctrl-10 = <0x00>;
					pinctrl-11 = <0x00>;
					pinctrl-12 = <0x00>;
					pinctrl-13 = <0x00>;
					pinctrl-14 = <0x00>;
				};
			};
		};

		fragment@23 {

			__overlay__ {
				tc_chgtype = <0x00>;
			};
		};

		fragment@27 {

			__overlay__ {

				tfcp_ta@1b {
					pinctrl-0 = <0x00>;
					pinctrl-1 = <0x00>;
				};
			};
		};

		fragment@30 {

			__overlay__ {
				charger = <0x00>;
			};
		};

		fragment@32 {

			__overlay__ {

				tc_audio {
					water_detect = <0x00>;
				};
			};
		};

		fragment@34 {

			__overlay__ {
				charger = <0x00>;
			};
		};

		fragment@36 {

			__overlay__ {
				charger = <0x00>;
			};
		};

		fragment@39 {

			__overlay__ {

				mediatek,speaker-codec {
					sound-dai = <0x00>;
				};
			};
		};

		fragment@41 {

			__overlay__ {

				fingerprint {
					pinctrl-0 = <0x00>;
					pinctrl-1 = <0x00>;
					pinctrl-2 = <0x00>;
					pinctrl-3 = <0x00>;
					pinctrl-4 = <0x00>;
					pinctrl-5 = <0x00>;
				};
			};
		};

		fragment@42 {

			__overlay__ {

				fingerprint@0 {
					pinctrl-0 = <0x00>;
					pinctrl-1 = <0x00>;
					pinctrl-2 = <0x00>;
					pinctrl-3 = <0x00>;
					pinctrl-4 = <0x00>;
					pinctrl-5 = <0x00>;
				};
			};
		};

		fragment@58 {

			__overlay__ {
				pinctrl-0 = <0x00>;
				pinctrl-1 = <0x00>;
				pinctrl-2 = <0x00>;
				pinctrl-3 = <0x00>;
				pinctrl-4 = <0x00>;
				pinctrl-5 = <0x00>;
				pinctrl-6 = <0x00>;
				pinctrl-7 = <0x00>;
				pinctrl-8 = <0x00>;
				pinctrl-9 = <0x00>;
				pinctrl-10 = <0x00>;
				cam0_vcama-supply = <0x00>;
				cam0_vcamd-supply = <0x00>;
				cam0_vcamio-supply = <0x00>;
				cam0_vcamrst-supply = <0x00>;
				cam1_vcama-supply = <0x00>;
				cam1_vcamd-supply = <0x00>;
				cam1_vcamio-supply = <0x00>;
				cam1_vcamrst-supply = <0x00>;
				cam2_vcama-supply = <0x00>;
			};
		};

		fragment@59 {

			__overlay__ {

				fakesensor {
					fakevin-supply = <0x00>;
				};
			};
		};

		fragment@62 {

			__overlay__ {

				flashlights_tran@63 {
					tran_regulator-supply = <0x00>;
					back-supply = <0x00>;
					back_warm-supply = <0x00>;
				};
			};
		};

		fragment@63 {

			__overlay__ {

				camera_main {
					thermal-sensors = <0x00>;
				};

				camera_sub {
					thermal-sensors = <0x00>;
				};
			};
		};
	};
};
